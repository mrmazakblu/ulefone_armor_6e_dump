/dts-v1/;

/ {
	model = "mt6771";
	compatible = "mediatek,mt6771";
	interrupt-parent = <0x1>;
	#address-cells = <0x2>;
	#size-cells = <0x2>;

	chosen {
		bootargs = "console=tty0 console=ttyS0,921600n1 vmalloc=496M slub_max_order=0 slub_debug=OFZPU androidboot.hardware=mt6771 firmware_class.path=/vendor/firmware loop.max_part=7";
		linux,phandle = <0x4e>;
		phandle = <0x4e>;
	};

	cpus {
		#address-cells = <0x1>;
		#size-cells = <0x0>;

		cpu@000 {
			device_type = "cpu";
			compatible = "arm,cortex-a53";
			reg = <0x0>;
			enable-method = "psci";
			clock-frequency = <0x8b799100>;
			cpu-idle-states = <0x2 0x3 0x4 0x5 0x6 0x7 0x8>;
			linux,phandle = <0x9>;
			phandle = <0x9>;
		};

		cpu@001 {
			device_type = "cpu";
			compatible = "arm,cortex-a53";
			reg = <0x1>;
			enable-method = "psci";
			clock-frequency = <0x8b799100>;
			cpu-idle-states = <0x2 0x3 0x4 0x5 0x6 0x7 0x8>;
			linux,phandle = <0xa>;
			phandle = <0xa>;
		};

		cpu@002 {
			device_type = "cpu";
			compatible = "arm,cortex-a53";
			reg = <0x2>;
			enable-method = "psci";
			clock-frequency = <0x8b799100>;
			cpu-idle-states = <0x2 0x3 0x4 0x5 0x6 0x7 0x8>;
			linux,phandle = <0xb>;
			phandle = <0xb>;
		};

		cpu@003 {
			device_type = "cpu";
			compatible = "arm,cortex-a53";
			reg = <0x3>;
			enable-method = "psci";
			clock-frequency = <0x8b799100>;
			cpu-idle-states = <0x2 0x3 0x4 0x5 0x6 0x7 0x8>;
			linux,phandle = <0xc>;
			phandle = <0xc>;
		};

		cpu@100 {
			device_type = "cpu";
			compatible = "arm,cortex-a73";
			reg = <0x100>;
			enable-method = "psci";
			clock-frequency = <0x8b799100>;
			cpu-idle-states = <0x2 0x3 0x4 0x5 0x6 0x7 0x8>;
			linux,phandle = <0xd>;
			phandle = <0xd>;
		};

		cpu@101 {
			device_type = "cpu";
			compatible = "arm,cortex-a73";
			reg = <0x101>;
			enable-method = "psci";
			clock-frequency = <0x8b799100>;
			cpu-idle-states = <0x2 0x3 0x4 0x5 0x6 0x7 0x8>;
			linux,phandle = <0xe>;
			phandle = <0xe>;
		};

		cpu@102 {
			device_type = "cpu";
			compatible = "arm,cortex-a73";
			reg = <0x102>;
			enable-method = "psci";
			clock-frequency = <0x8b799100>;
			cpu-idle-states = <0x2 0x3 0x4 0x5 0x6 0x7 0x8>;
			linux,phandle = <0xf>;
			phandle = <0xf>;
		};

		cpu@103 {
			device_type = "cpu";
			compatible = "arm,cortex-a73";
			reg = <0x103>;
			enable-method = "psci";
			clock-frequency = <0x8b799100>;
			cpu-idle-states = <0x2 0x3 0x4 0x5 0x6 0x7 0x8>;
			linux,phandle = <0x10>;
			phandle = <0x10>;
		};

		cpu-map {

			cluster0 {

				core0 {
					cpu = <0x9>;
				};

				core1 {
					cpu = <0xa>;
				};

				core2 {
					cpu = <0xb>;
				};

				core3 {
					cpu = <0xc>;
				};
			};

			cluster1 {

				core0 {
					cpu = <0xd>;
				};

				core1 {
					cpu = <0xe>;
				};

				core2 {
					cpu = <0xf>;
				};

				core3 {
					cpu = <0x10>;
				};
			};
		};

		idle-states {
			entry-method = "arm,psci";

			standby {
				compatible = "arm,idle-state";
				arm,psci-suspend-param = <0x1>;
				entry-latency-us = <0x258>;
				exit-latency-us = <0x258>;
				min-residency-us = <0x4b0>;
				linux,phandle = <0x2>;
				phandle = <0x2>;
			};

			mcdi-cpu {
				compatible = "arm,idle-state";
				arm,psci-suspend-param = <0x10001>;
				entry-latency-us = <0x258>;
				exit-latency-us = <0x258>;
				min-residency-us = <0x4b0>;
				linux,phandle = <0x3>;
				phandle = <0x3>;
			};

			mcdi-cluster {
				compatible = "arm,idle-state";
				arm,psci-suspend-param = <0x1010001>;
				entry-latency-us = <0x258>;
				exit-latency-us = <0x258>;
				min-residency-us = <0x4b0>;
				linux,phandle = <0x4>;
				phandle = <0x4>;
			};

			sodi {
				compatible = "arm,idle-state";
				arm,psci-suspend-param = <0x1010002>;
				entry-latency-us = <0x320>;
				exit-latency-us = <0x3e8>;
				min-residency-us = <0x7d0>;
				linux,phandle = <0x5>;
				phandle = <0x5>;
			};

			sodi3 {
				compatible = "arm,idle-state";
				arm,psci-suspend-param = <0x1010003>;
				entry-latency-us = <0x320>;
				exit-latency-us = <0x3e8>;
				min-residency-us = <0x7d0>;
				linux,phandle = <0x6>;
				phandle = <0x6>;
			};

			dpidle {
				compatible = "arm,idle-state";
				arm,psci-suspend-param = <0x1010004>;
				entry-latency-us = <0x320>;
				exit-latency-us = <0x3e8>;
				min-residency-us = <0x7d0>;
				linux,phandle = <0x7>;
				phandle = <0x7>;
			};

			suspend {
				compatible = "arm,idle-state";
				arm,psci-suspend-param = <0x1010005>;
				entry-latency-us = <0x320>;
				exit-latency-us = <0x3e8>;
				min-residency-us = <0x7d0>;
				linux,phandle = <0x8>;
				phandle = <0x8>;
			};
		};
	};

	psci {
		compatible = "arm,psci-1.0";
		method = "smc";
	};

	pmu {
		compatible = "arm,armv8-pmuv3";
		interrupt-parent = <0x11>;
		interrupts = <0x1 0x7 0x8>;
	};

	memory {
		device_type = "memory";
		reg = <0x0 0x40000000 0x0 0x1e605000>;
	};

	cpu_dbgapb@0d410000 {
		compatible = "mediatek,hw_dbg";
		num = <0x8>;
		reg = <0x0 0xd410000 0x0 0x1000 0x0 0xd510000 0x0 0x1000 0x0 0xd610000 0x0 0x1000 0x0 0xd710000 0x0 0x1000 0x0 0xd810000 0x0 0x1000 0x0 0xd910000 0x0 0x1000 0x0 0xda10000 0x0 0x1000 0x0 0xdb10000 0x0 0x1000>;
		linux,phandle = <0x4f>;
		phandle = <0x4f>;
	};

	atf_logger {
		compatible = "mediatek,atf_logger";
		interrupts = <0x0 0xf5 0x1>;
	};

	amms_control {
		compatible = "mediatek,amms";
		interrupts = <0x0 0x132 0x1>;
	};

	utos {
		compatible = "microtrust,utos";
		interrupts = <0x0 0x128 0x1 0x0 0x129 0x1>;
	};

	utos_tester {
		compatible = "microtrust,tester-v1";
	};

	tkcore {
		compatible = "trustkernel,tkcore";
		interrupts = <0x0 0x12a 0x0>;
	};

	msdc@11230000 {
		compatible = "mediatek,msdc";
		reg = <0x0 0x11230000 0x0 0x10000>;
		interrupts = <0x0 0x4d 0x8>;
		index = [00];
		clk_src = [01];
		bus-width = <0x8>;
		max-frequency = <0xbebc200>;
		cap-mmc-highspeed;
		msdc-sys-suspend;
		mmc-ddr-1_8v;
		mmc-hs200-1_8v;
		mmc-hs400-1_8v;
		non-removable;
		pinctl = <0x12>;
		register_setting = <0x13>;
		host_function = [00];
		bootable;
		status = "okay";
		vmmc-supply = <0x14>;
		clocks = <0x15 0x20 0x15 0x1d>;
		clock-names = "msdc0-clock", "msdc0-hclock";
		hw_dvfs = [00];
		linux,phandle = <0x39>;
		phandle = <0x39>;
	};

	msdc@11240000 {
		compatible = "mediatek,msdc";
		reg = <0x0 0x11240000 0x0 0x10000>;
		interrupts = <0x0 0x4e 0x8>;
		index = [01];
		clk_src = [04];
		bus-width = <0x4>;
		max-frequency = <0xbebc200>;
		msdc-sys-suspend;
		cap-sd-highspeed;
		sd-vmch-fastoff;
		sd-uhs-sdr12;
		sd-uhs-sdr25;
		sd-uhs-sdr50;
		sd-uhs-sdr104;
		sd-uhs-ddr50;
		pinctl = <0x16>;
		pinctl_sdr104 = <0x17>;
		pinctl_sdr50 = <0x18>;
		pinctl_ddr50 = <0x19>;
		register_setting = <0x1a>;
		host_function = [01];
		cd_level = [01];
		cd-gpios = <0x1b 0x3 0x0>;
		status = "okay";
		vmmc-supply = <0x1c>;
		vqmmc-supply = <0x1d>;
		clocks = <0x15 0x29 0x15 0x1e>;
		clock-names = "msdc1-clock", "msdc1-hclock";
		hw_dvfs = [00];
		linux,phandle = <0x50>;
		phandle = <0x50>;
	};

	msdc0_top@11f50000 {
		compatible = "mediatek,msdc0_top";
		reg = <0x0 0x11f50000 0x0 0x1000>;
	};

	msdc1_top@11e10000 {
		compatible = "mediatek,msdc1_top";
		reg = <0x0 0x11e10000 0x0 0x1000>;
	};

	reserved-memory {
		#address-cells = <0x2>;
		#size-cells = <0x2>;
		ranges;
		linux,phandle = <0x51>;
		phandle = <0x51>;

		pstore-reserved-memory@54410000 {
			compatible = "mediatek,pstore";
			reg = <0x0 0x54410000 0x0 0xe0000>;
		};

		ram_console-reserved-memory@54400000 {
			compatible = "mediatek,ram_console";
			reg = <0x0 0x54400000 0x0 0x10000>;
		};

		minirdump-reserved-memory@544f0000 {
			compatible = "mediatek,minirdump";
			reg = <0x0 0x544f0000 0x0 0x10000>;
		};

		reserve-memory-sspm_share {
			compatible = "mediatek,reserve-memory-sspm_share";
			no-map;
			status = "okay";
			size = <0x0 0x510000>;
			alignment = <0x0 0x10000>;
			alloc-ranges = <0x0 0x40000000 0x0 0x60000000>;
		};

		reserve-memory-scp_share {
			compatible = "mediatek,reserve-memory-scp_share";
			no-map;
			size = <0x0 0x1400000>;
			alignment = <0x0 0x1000000>;
			alloc-ranges = <0x0 0x40000000 0x0 0x50000000>;
		};

		consys-reserve-memory {
			compatible = "mediatek,consys-reserve-memory";
			no-map;
			size = <0x0 0x200000>;
			alignment = <0x0 0x200000>;
			alloc-ranges = <0x0 0x40000000 0x0 0x80000000>;
		};
	};

	interrupt-controller@0c000000 {
		compatible = "arm,gic-v3";
		#interrupt-cells = <0x3>;
		#address-cells = <0x2>;
		#size-cells = <0x2>;
		#redistributor-regions = <0x1>;
		interrupt-parent = <0x11>;
		interrupt-controller;
		reg = <0x0 0xc000000 0x0 0x40000 0x0 0xc100000 0x0 0x200000 0x0 0xc530a80 0x0 0x50>;
		interrupts = <0x1 0x9 0x4>;
		linux,phandle = <0x11>;
		phandle = <0x11>;
	};

	intpol-controller@0c530620 {
		compatible = "mediatek,mt6771-sysirq", "mediatek,mt6577-sysirq";
		interrupt-controller;
		#interrupt-cells = <0x3>;
		interrupt-parent = <0x11>;
		reg = <0x0 0xc530a80 0x0 0x50>;
		linux,phandle = <0x1>;
		phandle = <0x1>;
	};

	mobicore {
		compatible = "trustonic,mobicore";
		interrupts = <0x0 0x130 0x1>;
	};

	chipid@08000000 {
		compatible = "mediatek,chipid";
		reg = <0x0 0x8000000 0x0 0x4 0x0 0x8000004 0x0 0x4 0x0 0x8000008 0x0 0x4 0x0 0x800000c 0x0 0x4>;
	};

	timer {
		compatible = "arm,armv8-timer";
		interrupt-parent = <0x11>;
		interrupts = <0x1 0xd 0x8 0x1 0xe 0x8 0x1 0xb 0x8 0x1 0xa 0x8>;
		clock-frequency = <0xc65d40>;
		linux,phandle = <0x52>;
		phandle = <0x52>;
	};

	clocks {

		clk_null {
			compatible = "fixed-clock";
			#clock-cells = <0x0>;
			clock-frequency = <0x0>;
			linux,phandle = <0x53>;
			phandle = <0x53>;
		};

		clk26m {
			compatible = "fixed-clock";
			#clock-cells = <0x0>;
			clock-frequency = <0x18cba80>;
			linux,phandle = <0x3d>;
			phandle = <0x3d>;
		};

		clk32k {
			compatible = "fixed-clock";
			#clock-cells = <0x0>;
			clock-frequency = <0x7d00>;
			linux,phandle = <0x2a>;
			phandle = <0x2a>;
		};
	};

	topckgen@10000000 {
		compatible = "mediatek,topckgen", "syscon";
		reg = <0x0 0x10000000 0x0 0x1000>;
		#clock-cells = <0x1>;
		linux,phandle = <0x3f>;
		phandle = <0x3f>;
	};

	infracfg_ao@10001000 {
		compatible = "mediatek,infracfg_ao", "syscon";
		reg = <0x0 0x10001000 0x0 0x1000>;
		interrupts = <0x0 0x96 0x1>;
		#clock-cells = <0x1>;
		linux,phandle = <0x15>;
		phandle = <0x15>;
	};

	scpsys@10001000 {
		compatible = "mediatek,scpsys";
		reg = <0x0 0x10001000 0x0 0x1000 0x0 0x10006000 0x0 0x1000 0x0 0x1020e000 0x0 0x1000 0x0 0x10000000 0x0 0x1000 0x0 0x1a001000 0x0 0x1000 0x0 0x14019000 0x0 0x1000>;
		#clock-cells = <0x1>;
		linux,phandle = <0x2b>;
		phandle = <0x2b>;
	};

	iocfg_0@10002000 {
		compatible = "mediatek,iocfg_0";
		reg = <0x0 0x10002000 0x0 0x1000>;
	};

	iocfg_1@10002200 {
		compatible = "mediatek,iocfg_1";
		reg = <0x0 0x10002200 0x0 0x1000>;
	};

	iocfg_2@10002400 {
		compatible = "mediatek,iocfg_2";
		reg = <0x0 0x10002400 0x0 0x1000>;
	};

	iocfg_3@10002600 {
		compatible = "mediatek,iocfg_3";
		reg = <0x0 0x10002600 0x0 0x1000>;
	};

	iocfg_4@10002800 {
		compatible = "mediatek,iocfg_4";
		reg = <0x0 0x10002800 0x0 0x1000>;
	};

	iocfg_5@10002a00 {
		compatible = "mediatek,iocfg_5";
		reg = <0x0 0x10002a00 0x0 0x1000>;
	};

	iocfg_6@10002c00 {
		compatible = "mediatek,iocfg_6";
		reg = <0x0 0x10002c00 0x0 0x1000>;
	};

	pericfg@10003000 {
		compatible = "mediatek,pericfg";
		reg = <0x0 0x10003000 0x0 0x1000>;
	};

	gpio {
		compatible = "mediatek,gpio_usage_mapping";
		linux,phandle = <0x54>;
		phandle = <0x54>;
	};

	gpio@10005000 {
		compatible = "mediatek,gpio";
		reg = <0x0 0x10005000 0x0 0x1000>;
		linux,phandle = <0x55>;
		phandle = <0x55>;
	};

	syscfg_pctl_a@10005000 {
		compatible = "mediatek,pctl-a-syscfg", "syscon";
		reg = <0x0 0x10005000 0x0 0x1000>;
		linux,phandle = <0x1e>;
		phandle = <0x1e>;
	};

	syscfg_pctl_0@11f20000 {
		compatible = "mediatek,pctl-0-syscfg", "syscon";
		reg = <0x0 0x11f20000 0x0 0x1000>;
		linux,phandle = <0x1f>;
		phandle = <0x1f>;
	};

	syscfg_pctl_1@11e80000 {
		compatible = "mediatek,pctl-1-syscfg", "syscon";
		reg = <0x0 0x11e80000 0x0 0x1000>;
		linux,phandle = <0x20>;
		phandle = <0x20>;
	};

	syscfg_pctl_2@11e70000 {
		compatible = "mediatek,pctl-2-syscfg", "syscon";
		reg = <0x0 0x11e70000 0x0 0x1000>;
		linux,phandle = <0x21>;
		phandle = <0x21>;
	};

	syscfg_pctl_3@11e90000 {
		compatible = "mediatek,pctl-3-syscfg", "syscon";
		reg = <0x0 0x11e90000 0x0 0x1000>;
		linux,phandle = <0x22>;
		phandle = <0x22>;
	};

	syscfg_pctl_4@11d30000 {
		compatible = "mediatek,pctl-4-syscfg", "syscon";
		reg = <0x0 0x11d30000 0x0 0x1000>;
		linux,phandle = <0x23>;
		phandle = <0x23>;
	};

	syscfg_pctl_5@11d20000 {
		compatible = "mediatek,pctl-5-syscfg", "syscon";
		reg = <0x0 0x11d20000 0x0 0x1000>;
		linux,phandle = <0x24>;
		phandle = <0x24>;
	};

	syscfg_pctl_6@11c50000 {
		compatible = "mediatek,pctl-6-syscfg", "syscon";
		reg = <0x0 0x11c50000 0x0 0x1000>;
		linux,phandle = <0x25>;
		phandle = <0x25>;
	};

	syscfg_pctl_7@11f30000 {
		compatible = "mediatek,pctl-7-syscfg", "syscon";
		reg = <0x0 0x11f30000 0x0 0x1000>;
		linux,phandle = <0x26>;
		phandle = <0x26>;
	};

	pinctrl@1000b000 {
		compatible = "mediatek,pinctrl";
		reg = <0x0 0x1000b000 0x0 0x1000>;
		mediatek,pctl-regmap = <0x1e 0x1f 0x20 0x21 0x22 0x23 0x24 0x25 0x26>;
		pins-are-numbered;
		gpio-controller;
		#gpio-cells = <0x2>;
		interrupt-controller;
		#interrupt-cells = <0x4>;
		interrupts = <0x0 0xb1 0x4>;
		linux,phandle = <0x1b>;
		phandle = <0x1b>;

		msdc0@default {
			linux,phandle = <0x12>;
			phandle = <0x12>;

			pins_cmd {
				drive-strength = [04];
			};

			pins_dat {
				drive-strength = [04];
			};

			pins_clk {
				drive-strength = [04];
			};

			pins_rst {
				drive-strength = [04];
			};

			pins_ds {
				drive-strength = [04];
			};
		};

		msdc0@register_default {
			cmd_edge = [00];
			rdata_edge = [00];
			wdata_edge = [00];
			linux,phandle = <0x13>;
			phandle = <0x13>;
		};

		msdc1@default {
			linux,phandle = <0x16>;
			phandle = <0x16>;

			pins_cmd {
				drive-strength = [03];
			};

			pins_dat {
				drive-strength = [03];
			};

			pins_clk {
				drive-strength = [03];
			};
		};

		msdc1@sdr104 {
			linux,phandle = <0x17>;
			phandle = <0x17>;

			pins_cmd {
				drive-strength = [03];
			};

			pins_dat {
				drive-strength = [03];
			};

			pins_clk {
				drive-strength = [03];
			};
		};

		msdc1@sdr50 {
			linux,phandle = <0x18>;
			phandle = <0x18>;

			pins_cmd {
				drive-strength = [03];
			};

			pins_dat {
				drive-strength = [03];
			};

			pins_clk {
				drive-strength = [03];
			};
		};

		msdc1@ddr50 {
			linux,phandle = <0x19>;
			phandle = <0x19>;

			pins_cmd {
				drive-strength = [03];
			};

			pins_dat {
				drive-strength = [03];
			};

			pins_clk {
				drive-strength = [03];
			};
		};

		msdc1@register_default {
			cmd_edge = [00];
			rdata_edge = [00];
			wdata_edge = [00];
			linux,phandle = <0x1a>;
			phandle = <0x1a>;
		};
	};

	i2c@11007000 {
		compatible = "mediatek,mt6771-i2c";
		id = <0x0>;
		reg = <0x0 0x11007000 0x0 0x1000 0x0 0x11000080 0x0 0x80>;
		interrupts = <0x0 0x51 0x8>;
		clocks = <0x15 0xb 0x15 0x2b>;
		clock-names = "main", "dma";
		clock-div = <0x5>;
		mediatek,hs_only;
		mediatek,skip_scp_sema;
		linux,phandle = <0x56>;
		phandle = <0x56>;
	};

	i2c@11011000 {
		compatible = "mediatek,mt6771-i2c";
		id = <0x1>;
		reg = <0x0 0x11011000 0x0 0x1000 0x0 0x11000480 0x0 0x80>;
		interrupts = <0x0 0x55 0x8>;
		clocks = <0x15 0x3a 0x15 0x2b>;
		clock-names = "main", "dma";
		clock-div = <0x5>;
		mediatek,hs_only;
		mediatek,skip_scp_sema;
		linux,phandle = <0x57>;
		phandle = <0x57>;
	};

	i2c@11009000 {
		compatible = "mediatek,mt6771-i2c";
		id = <0x2>;
		reg = <0x0 0x11009000 0x0 0x1000 0x0 0x11000280 0x0 0x80>;
		interrupts = <0x0 0x53 0x8>;
		clocks = <0x15 0xd 0x15 0x2b 0x15 0x4a>;
		clock-names = "main", "dma", "arb";
		clock-div = <0x5>;
		ch_offset_default = <0x100>;
		ccu-ch-offset = <0x200>;
		mediatek,hs_only;
		linux,phandle = <0x58>;
		phandle = <0x58>;
	};

	i2c@1100f000 {
		compatible = "mediatek,mt6771-i2c";
		id = <0x3>;
		reg = <0x0 0x1100f000 0x0 0x1000 0x0 0x11000400 0x0 0x80>;
		interrupts = <0x0 0x54 0x8>;
		clocks = <0x15 0xe 0x15 0x2b>;
		clock-names = "main", "dma";
		clock-div = <0x5>;
		mediatek,hs_only;
		linux,phandle = <0x59>;
		phandle = <0x59>;
	};

	i2c@11008000 {
		compatible = "mediatek,mt6771-i2c";
		id = <0x4>;
		reg = <0x0 0x11008000 0x0 0x1000 0x0 0x11000100 0x0 0x80>;
		interrupts = <0x0 0x52 0x8>;
		clocks = <0x15 0xc 0x15 0x2b 0x15 0x48>;
		clock-names = "main", "dma", "arb";
		clock-div = <0x5>;
		ch_offset_default = <0x100>;
		ccu-ch-offset = <0x200>;
		mediatek,hs_only;
		linux,phandle = <0x5a>;
		phandle = <0x5a>;
	};

	i2c@11017000 {
		compatible = "mediatek,mt6771-i2c";
		id = <0x5>;
		reg = <0x0 0x11017000 0x0 0x1000 0x0 0x11000580 0x0 0x80>;
		interrupts = <0x0 0x85 0x8>;
		clocks = <0x15 0x47 0x15 0x2b 0x15 0x46>;
		clock-names = "main", "dma", "arb";
		clock-div = <0x5>;
		mediatek,hs_only;
		linux,phandle = <0x5b>;
		phandle = <0x5b>;
	};

	i2c@11005000 {
		compatible = "mediatek,mt6771-i2c";
		id = <0x6>;
		reg = <0x0 0x11005000 0x0 0x1000 0x0 0x11000600 0x0 0x80>;
		interrupts = <0x0 0x57 0x8>;
		clocks = <0x15 0x58 0x15 0x2b>;
		clock-names = "main", "dma";
		clock-div = <0x5>;
		mediatek,hs_only;
		linux,phandle = <0x5c>;
		phandle = <0x5c>;
	};

	i2c@1101a000 {
		compatible = "mediatek,mt6771-i2c";
		id = <0x7>;
		reg = <0x0 0x1101a000 0x0 0x1000 0x0 0x11000680 0x0 0x80>;
		interrupts = <0x0 0x58 0x8>;
		clocks = <0x15 0x63 0x15 0x2b>;
		clock-names = "main", "dma";
		clock-div = <0x5>;
		mediatek,hs_only;
		linux,phandle = <0x5d>;
		phandle = <0x5d>;
	};

	i2c@1101b000 {
		compatible = "mediatek,mt6771-i2c";
		id = <0x8>;
		reg = <0x0 0x1101b000 0x0 0x1000 0x0 0x11000700 0x0 0x80>;
		interrupts = <0x0 0x59 0x8>;
		clocks = <0x15 0x64 0x15 0x2b>;
		clock-names = "main", "dma";
		clock-div = <0x5>;
		mediatek,hs_only;
		linux,phandle = <0x5e>;
		phandle = <0x5e>;
	};

	i2c@11014000 {
		compatible = "mediatek,mt6771-i2c";
		id = <0x9>;
		reg = <0x0 0x11014000 0x0 0x1000 0x0 0x11000180 0x0 0x80>;
		interrupts = <0x0 0x83 0x8>;
		clocks = <0x15 0x49 0x15 0x2b 0x15 0x48>;
		clock-names = "main", "dma", "arb";
		clock-div = <0x5>;
		mediatek,hs_only;
		linux,phandle = <0x5f>;
		phandle = <0x5f>;
	};

	i2c@11015000 {
		compatible = "mediatek,mt6771-i2c";
		id = <0xa>;
		reg = <0x0 0x11015000 0x0 0x1000 0x0 0x11000300 0x0 0x80>;
		interrupts = <0x0 0x84 0x8>;
		clocks = <0x15 0x4b 0x15 0x2b 0x15 0x4a>;
		clock-names = "main", "dma", "arb";
		clock-div = <0x5>;
		mediatek,hs_only;
		linux,phandle = <0x60>;
		phandle = <0x60>;
	};

	i2c@11016000 {
		compatible = "mediatek,mt6771-i2c";
		id = <0xb>;
		reg = <0x0 0x11016000 0x0 0x1000 0x0 0x11000500 0x0 0x80>;
		interrupts = <0x0 0x56 0x8>;
		clocks = <0x15 0x45 0x15 0x2b 0x15 0x46>;
		clock-names = "main", "dma", "arb";
		clock-div = <0x5>;
		mediatek,hs_only;
		linux,phandle = <0x61>;
		phandle = <0x61>;
	};

	sspm@10440000 {
		compatible = "mediatek,sspm";
		reg = <0x0 0x10440000 0x0 0x10000 0x0 0x10450000 0x0 0x100 0x0 0x10451000 0x0 0x8 0x0 0x10460000 0x0 0x100 0x0 0x10461000 0x0 0x8 0x0 0x10470000 0x0 0x100 0x0 0x10471000 0x0 0x8 0x0 0x10480000 0x0 0x100 0x0 0x10481000 0x0 0x8 0x0 0x10490000 0x0 0x100 0x0 0x10491000 0x0 0x8>;
		reg-names = "cfgreg", "mbox0_base", "mbox0_ctrl", "mbox1_base", "mbox1_ctrl", "mbox2_base", "mbox2_ctrl", "mbox3_base", "mbox3_ctrl", "mbox4_base", "mbox4_ctrl";
		interrupts = <0x0 0xd0 0x4 0x0 0xd3 0x4 0x0 0xd4 0x4 0x0 0xd5 0x4 0x0 0xd6 0x4 0x0 0xd7 0x4>;
		interrupt-names = "ipc", "mbox0", "mbox1", "mbox2", "mbox3", "mbox4";
	};

	sleep@10006000 {
		compatible = "mediatek,sleep";
		reg = <0x0 0x10006000 0x0 0x1000>;
		interrupts = <0x0 0xbb 0x8>;
		wakeup-source = <0x27 0x0 0x4 0x28 0x1 0x20 0x29 0x3 0x2000000>;
	};

	toprgu@10007000 {
		compatible = "mediatek,toprgu";
		reg = <0x0 0x10007000 0x0 0x1000>;
		interrupts = <0x0 0x8e 0x0>;
	};

	apxgpt@10008000 {
		compatible = "mediatek,apxgpt";
		reg = <0x0 0x10008000 0x0 0x100>;
		interrupts = <0x0 0xb0 0x8>;
		clocks = <0x2a>;
	};

	rsvd@10009000 {
		compatible = "mediatek,rsvd";
		reg = <0x0 0x10009000 0x0 0x1000>;
	};

	hacc@1000a000 {
		compatible = "mediatek,hacc";
		reg = <0x0 0x1000a000 0x0 0x1000>;
		interrupts = <0x0 0xc3 0x8>;
	};

	apirq@1000b000 {
		compatible = "mediatek,apirq";
		reg = <0x0 0x1000b000 0x0 0x1000>;
		interrupts = <0x0 0xb1 0x4>;
	};

	apmixed@1000c000 {
		compatible = "mediatek,apmixed", "syscon";
		reg = <0x0 0x1000c000 0x0 0x1000>;
		#clock-cells = <0x1>;
		linux,phandle = <0x62>;
		phandle = <0x62>;
	};

	fhctl@1000ce00 {
		compatible = "mediatek,fhctl";
		reg = <0x0 0x1000ce00 0x0 0x1000>;
	};

	pwrap@1000d000 {
		compatible = "mediatek,pwrap";
		reg = <0x0 0x1000d000 0x0 0x1000>;
		interrupts = <0x0 0xb9 0x4>;

		pmic_irq {
			compatible = "mediatek,pmic-eint";
			interrupt-controller;
			linux,phandle = <0x63>;
			phandle = <0x63>;
		};
	};

	pwrap_mpu@1000d000 {
		compatible = "mediatek,pwrap_mpu";
		reg = <0x0 0x1000d000 0x0 0x1000>;
	};

	pwrap_p2p@1005e000 {
		compatible = "mediatek,pwrap_p2p";
		reg = <0x0 0x105cb000 0x0 0x1000>;
	};

	pwrap_md32@10448000 {
		compatible = "mediatek,pwrap_md32";
		reg = <0x0 0x10448000 0x0 0x1000>;
	};

	sleep_reg_md@1000f000 {
		compatible = "mediatek,sleep_reg_md";
		reg = <0x0 0x1000f000 0x0 0x1000>;
	};

	kp@10010000 {
		compatible = "mediatek,kp";
		reg = <0x0 0x10010000 0x0 0x1000>;
		interrupts = <0x0 0xba 0x2>;
		linux,phandle = <0x27>;
		phandle = <0x27>;
	};

	mrdump_ext_rst {
		compatible = "mediatek, mrdump_ext_rst-eint";
		source = "EINT";
		mode = "IRQ";
		status = "okay";
		linux,phandle = <0x64>;
		phandle = <0x64>;
	};

	topmisc@10011000 {
		compatible = "mediatek,topmisc";
		reg = <0x0 0x10011000 0x0 0x1000>;
	};

	dvfsrc_top@10012000 {
		compatible = "mediatek,dvfsrc_top";
		reg = <0x0 0x10012000 0x0 0x1000 0x0 0x11bb80 0x0 0x80>;
	};

	apcldmain_ao@10014000 {
		compatible = "mediatek,apcldmain_ao";
		reg = <0x0 0x10014000 0x0 0x1000>;
	};

	apcldmaout_ao@10014400 {
		compatible = "mediatek,apcldmaout_ao";
		reg = <0x0 0x10014400 0x0 0x1000>;
	};

	apcldmamisc_ao@10014800 {
		compatible = "mediatek,apcldmamisc_ao";
		reg = <0x0 0x10014800 0x0 0x1000>;
	};

	devapc_mpu_ao@10015000 {
		compatible = "mediatek,devapc_mpu_ao";
		reg = <0x0 0x10015000 0x0 0x1000>;
	};

	aes_top0@10016000 {
		compatible = "mediatek,aes_top0";
		reg = <0x0 0x10016000 0x0 0x1000>;
	};

	sys_timer@10017000 {
		compatible = "mediatek,sys_timer";
		reg = <0x0 0x10017000 0x0 0x1000>;
		reg-names = "sys_timer_base";
		interrupts = <0x0 0xca 0x4>;
	};

	modem_temp_share@10018000 {
		compatible = "mediatek,modem_temp_share";
		reg = <0x0 0x10018000 0x0 0x1000>;
	};

	mbist_ao@10013000 {
		compatible = "mediatek,mbist_ao";
		reg = <0x0 0x10013000 0x0 0x1000>;
	};

	security_ao@1001a000 {
		compatible = "mediatek,security_ao";
		reg = <0x0 0x1001a000 0x0 0x1000>;
	};

	topckgen_ao@1001b000 {
		compatible = "mediatek,topckgen_ao";
		reg = <0x0 0x1001b000 0x0 0x1000>;
	};

	scp@10500000 {
		compatible = "mediatek,scp";
		status = "okay";
		reg = <0x0 0x10500000 0x0 0x80000 0x0 0x105c0000 0x0 0x3000 0x0 0x105c4000 0x0 0x1000 0x0 0x105d4000 0x0 0x6000>;
		interrupts = <0x0 0xae 0x4>;
		linux,phandle = <0x65>;
		phandle = <0x65>;
	};

	scp_cfgreg@105c0000 {
		compatible = "mediatek,scp_cfgreg";
		reg = <0x0 0x105c0000 0x0 0x1000>;
	};

	scp_mad@105c1000 {
		compatible = "mediatek,scp_mad";
		reg = <0x0 0x105c1000 0x0 0x1000>;
	};

	scp_intc@105c2000 {
		compatible = "mediatek,scp_intc";
		reg = <0x0 0x105c2000 0x0 0x1000>;
	};

	scp_timer@105c3000 {
		compatible = "mediatek,scp_timer";
		reg = <0x0 0x105c3000 0x0 0x1000>;
	};

	scp_clk_ctrl@105c4000 {
		compatible = "mediatek,scp_clk_ctrl";
		reg = <0x0 0x105c4000 0x0 0x1000>;
	};

	scp_i2c0@105c5000 {
		compatible = "mediatek,scp_i2c0";
		reg = <0x0 0x105c5000 0x0 0x1000>;
	};

	scp_i2c1@105c6000 {
		compatible = "mediatek,scp_i2c1";
		reg = <0x0 0x105c6000 0x0 0x1000>;
	};

	scp_i2c2@105c7000 {
		compatible = "mediatek,scp_i2c2";
		reg = <0x0 0x105c7000 0x0 0x1000>;
	};

	scp_gpio@105c8000 {
		compatible = "mediatek,scp_gpio";
		reg = <0x0 0x105c8000 0x0 0x1000>;
	};

	scp_uart@105c9000 {
		compatible = "mediatek,scp_uart";
		reg = <0x0 0x105c9000 0x0 0x1000>;
	};

	scp_cirq_eint@105ca000 {
		compatible = "mediatek,scp_cirq_eint";
		reg = <0x0 0x105ca000 0x0 0x1000>;
	};

	scp_dma@105cd000 {
		compatible = "mediatek,scp_dma";
		reg = <0x0 0x105cd000 0x0 0x1000>;
	};

	scp_uart1@105ce000 {
		compatible = "mediatek,scp_uart1";
		reg = <0x0 0x105ce000 0x0 0x1000>;
	};

	scp_spi0@105cf000 {
		compatible = "mediatek,scp_spi0";
		reg = <0x0 0x105cf000 0x0 0x1000>;
	};

	scp_spi1@105d0000 {
		compatible = "mediatek,scp_spi1";
		reg = <0x0 0x105d0000 0x0 0x1000>;
	};

	scp_spi2@105d1000 {
		compatible = "mediatek,scp_spi2";
		reg = <0x0 0x105d1000 0x0 0x1000>;
	};

	dbgapb@0d000000 {
		compatible = "mediatek,dbgapb";
		reg = <0x0 0xd000000 0x0 0x1000>;
	};

	mcucfg@0c530000 {
		compatible = "mediatek,mcucfg";
		reg = <0x0 0xc530000 0x0 0x1000>;
		interrupts = <0x0 0x0 0x8>;
	};

	mp0_cpucfg@0c530000 {
		compatible = "mediatek,mp0_cpucfg";
		reg = <0x0 0xc530000 0x0 0x1000>;
	};

	mp1_cpucfg@0c530200 {
		compatible = "mediatek,mp1_cpucfg";
		reg = <0x0 0xc530200 0x0 0x1000>;
	};

	mcu_misccfg@0c530400 {
		compatible = "mediatek,mcu_misccfg";
		reg = <0x0 0xc530400 0x0 0x1000>;
	};

	mcu_misc1cfg@0c530800 {
		compatible = "mediatek,mcu_misc1cfg";
		reg = <0x0 0xc530800 0x0 0x1000>;
	};

	mp2_ca15m_config@0c532000 {
		compatible = "mediatek,mp2_ca15m_config";
		reg = <0x0 0xc532000 0x0 0x1000>;
	};

	mcucfg_mp0_counter@0c530000 {
		compatible = "mediatek,mcucfg_mp0_counter";
		reg = <0x0 0xc530000 0x0 0x2000>;
	};

	mcucfg_mp2_counter@0c532000 {
		compatible = "mediatek,mcucfg_mp2_counter";
		reg = <0x0 0xc532000 0x0 0x1000>;
	};

	infracfg@1020e000 {
		compatible = "mediatek,infracfg";
		reg = <0x0 0x1020e000 0x0 0x1000>;
	};

	sramrom@10214000 {
		compatible = "mediatek,sramrom";
		reg = <0x0 0x10214000 0x0 0x1000>;
	};

	emi@10219000 {
		compatible = "mediatek,emi";
		reg = <0x0 0x10219000 0x0 0x1000 0x0 0x10226000 0x0 0x1000 0x0 0x1022d000 0x0 0x1000 0x0 0x10235000 0x0 0x1000>;
		interrupts = <0x0 0x93 0x8 0x0 0x94 0x4 0x0 0x9b 0x4>;
	};

	sys_cirq@10204000 {
		compatible = "mediatek,sys_cirq";
		reg = <0x0 0x10204000 0x0 0x1000>;
		mediatek,cirq_num = <0xe7>;
		mediatek,spi_start_offset = <0x48>;
		interrupts = <0x0 0x12f 0x8>;
	};

	m4u@10205000 {
		cell-index = <0x0>;
		compatible = "mediatek,m4u";
		reg = <0x0 0x10205000 0x0 0x1000>;
		interrupts = <0x0 0xa6 0x8>;
	};

	devapc@10207000 {
		compatible = "mediatek,devapc";
		reg = <0x0 0x10207000 0x0 0x1000>;
		interrupts = <0x0 0x91 0x8>;
		clocks = <0x15 0x2d>;
		clock-names = "devapc-infra-clock";
	};

	bus_dbg@10208000 {
		compatible = "mediatek,bus_dbg-v2";
		reg = <0x0 0x10208000 0x0 0x1000>;
		interrupts = <0x0 0x90 0x8>;
	};

	ap_ccif0@10209000 {
		compatible = "mediatek,ap_ccif0";
		reg = <0x0 0x10209000 0x0 0x1000>;
		interrupts = <0x0 0x97 0x8>;
	};

	md_ccif0@1020a000 {
		compatible = "mediatek,md_ccif0";
		reg = <0x0 0x1020a000 0x0 0x1000>;
	};

	ap_ccif1@1020b000 {
		compatible = "mediatek,ap_ccif1";
		reg = <0x0 0x1020b000 0x0 0x1000>;
		interrupts = <0x0 0x99 0x8>;
	};

	md_ccif1@1020c000 {
		compatible = "mediatek,md_ccif1";
		reg = <0x0 0x1020c000 0x0 0x1000>;
	};

	ap_ccif2@1023c000 {
		compatible = "mediatek,ap_ccif2";
		reg = <0x0 0x1023c000 0x0 0x1000>;
		interrupts = <0x0 0x9c 0x8>;
	};

	md_ccif2@1023d000 {
		compatible = "mediatek,md_ccif2";
		reg = <0x0 0x1023d000 0x0 0x1000>;
	};

	ap_ccif3@1023e000 {
		compatible = "mediatek,ap_ccif3";
		reg = <0x0 0x1023e000 0x0 0x1000>;
		interrupts = <0x0 0x9d 0x8>;
	};

	md_ccif3@1023f000 {
		compatible = "mediatek,md_ccif3";
		reg = <0x0 0x1023f000 0x0 0x1000>;
	};

	infra_mbist@1020d000 {
		compatible = "mediatek,infra_mbist";
		reg = <0x0 0x1020d000 0x0 0x1000>;
	};

	trng@1020f000 {
		compatible = "mediatek,trng";
		reg = <0x0 0x1020f000 0x0 0x1000>;
		interrupts = <0x0 0xa9 0x8>;
	};

	dxcc_sec@10210000 {
		compatible = "mediatek,dxcc_sec";
		reg = <0x0 0x10210000 0x0 0x1000>;
		interrupts = <0x0 0xaa 0x4>;
	};

	smi_common_ao@10211000 {
		compatible = "mediatek,smi_common_ao";
		reg = <0x0 0x10211000 0x0 0x1000>;
	};

	cq_dma@10212000 {
		compatible = "mediatek,mt-cqdma-v1";
		reg = <0x0 0x10212000 0x0 0x80 0x0 0x10212080 0x0 0x80 0x0 0x10212100 0x0 0x80>;
		interrupts = <0x0 0x73 0x8 0x0 0x74 0x8 0x0 0x75 0x8>;
		nr_channel = <0x3>;
		clocks = <0x15 0x4e>;
		clock-names = "cqdma";
	};

	wifi@180f0000 {
		compatible = "mediatek,wifi";
		reg = <0x0 0x180f0000 0x0 0x1100 0x0 0x10212180 0x0 0x6c 0x0 0x10001000 0x0 0x1000 0x0 0x180e0000 0x0 0x70>;
		interrupts = <0x0 0x122 0x8 0x0 0x76 0x8>;
		clocks = <0x15 0x4e>;
		clock-names = "wifi-dma";
		hardware-values = <0x788 0xa5800 0xa5800>;
		linux,phandle = <0x66>;
		phandle = <0x66>;
	};

	mipi_tx0@11e50000 {
		compatible = "mediatek,mipi_tx0";
		reg = <0x0 0x11e50000 0x0 0x1000>;
	};

	mipi_tx1@10216000 {
		compatible = "mediatek,mipi_tx1";
		reg = <0x0 0x10216000 0x0 0x1000>;
	};

	mipi_rx_ana_csi0a@11c80000 {
		compatible = "mediatek,mipi_rx_ana_csi0a";
		reg = <0x0 0x11c80000 0x0 0x1000>;
	};

	mipi_rx_ana_csi0b@11c81000 {
		compatible = "mediatek,mipi_rx_ana_csi0b";
		reg = <0x0 0x11c81000 0x0 0x1000>;
	};

	mipi_rx_ana_csi1a@11c82000 {
		compatible = "mediatek,mipi_rx_ana_csi1a";
		reg = <0x0 0x11c82000 0x0 0x1000>;
	};

	mipi_rx_ana_csi1b@11c83000 {
		compatible = "mediatek,mipi_rx_ana_csi1b";
		reg = <0x0 0x11c83000 0x0 0x1000>;
	};

	mipi_rx_ana_csi2a@11c84000 {
		compatible = "mediatek,mipi_rx_ana_csi2a";
		reg = <0x0 0x11c84000 0x0 0x1000>;
	};

	mipi_rx_ana_csi2b@11c85000 {
		compatible = "mediatek,mipi_rx_ana_csi2b";
		reg = <0x0 0x11c85000 0x0 0x1000>;
	};

	gcpu_rsa@1021a000 {
		compatible = "mediatek,gcpu_rsa";
		reg = <0x0 0x1021a000 0x0 0x1000>;
	};

	apcldmain@1021b000 {
		compatible = "mediatek,apcldmain";
		reg = <0x0 0x1021b000 0x0 0x1000>;
	};

	apcldmaout@1021b400 {
		compatible = "mediatek,apcldmaout";
		reg = <0x0 0x1021b400 0x0 0x1000>;
	};

	apcldmamisc@1021b800 {
		compatible = "mediatek,apcldmamisc";
		reg = <0x0 0x1021b800 0x0 0x1000>;
		interrupts = <0x0 0xad 0x4>;
	};

	mdcldmain@1021c000 {
		compatible = "mediatek,mdcldmain";
		reg = <0x0 0x1021c000 0x0 0x1000>;
	};

	mdcldmaout@1021c400 {
		compatible = "mediatek,mdcldmaout";
		reg = <0x0 0x1021c400 0x0 0x1000>;
	};

	mdcldmamisc@1021c800 {
		compatible = "mediatek,mdcldmamisc";
		reg = <0x0 0x1021c800 0x0 0x1000>;
	};

	infra_md@1021d000 {
		compatible = "mediatek,infra_md";
		reg = <0x0 0x1021d000 0x0 0x1000>;
	};

	mdcldma@10014000 {
		compatible = "mediatek,mdcldma";
		reg = <0x0 0x10014000 0x0 0x1000 0x0 0x1021b000 0x0 0x1000 0x0 0x10209000 0x0 0x1000 0x0 0x1020a000 0x0 0x1000>;
		interrupts = <0x0 0xad 0x4 0x0 0x97 0x8 0x0 0x98 0x8 0x0 0x11b 0x2>;
		mediatek,md_id = <0x0>;
		mediatek,cldma_capability = <0x6>;
		clocks = <0x2b 0x1 0x15 0x37 0x15 0x2e 0x15 0x31 0x15 0x26 0x15 0x27 0x15 0x5d 0x15 0x5e>;
		clock-names = "scp-sys-md1-main", "infra-cldma-bclk", "infra-ccif-ap", "infra-ccif-md", "infra-ccif1-ap", "infra-ccif1-md", "infra-ccif2-ap", "infra-ccif2-md";
		linux,phandle = <0x29>;
		phandle = <0x29>;
	};

	infra_md_cfg@1021d000 {
		compatible = "mediatek,infra_md_cfg";
		reg = <0x0 0x1021d000 0x0 0x1000>;
	};

	bpi_bsi_slv0@1021e000 {
		compatible = "mediatek,bpi_bsi_slv0";
		reg = <0x0 0x1021e000 0x0 0x1000>;
	};

	bpi_bsi_slv1@1021f000 {
		compatible = "mediatek,bpi_bsi_slv1";
		reg = <0x0 0x1021f000 0x0 0x1000>;
	};

	bpi_bsi_slv2@10225000 {
		compatible = "mediatek,bpi_bsi_slv2";
		reg = <0x0 0x10225000 0x0 0x1000>;
	};

	dvfsp@10227000 {
		compatible = "mediatek,dvfsp";
		reg = <0x0 0x10227000 0x0 0x1000>;
		interrupts = <0x0 0xab 0x8>;
	};

	dvfsp@0011bc00 {
		compatible = "mediatek,mt6771-dvfsp";
		reg = <0x0 0x11bc00 0x0 0x1400 0x0 0x11bc00 0x0 0x1400>;
	};

	mcdi@0011b000 {
		compatible = "mediatek,mt6771-mcdi";
		reg = <0x0 0x11b000 0x0 0x800>;
	};

	dramc@1022a000 {
		compatible = "mediatek,dramc";
		reg = <0x0 0x1022a000 0x0 0x2000 0x0 0x10232000 0x0 0x2000 0x0 0x1022c000 0x0 0x1000 0x0 0x10234000 0x0 0x1000 0x0 0x10228000 0x0 0x2000 0x0 0x10230000 0x0 0x2000 0x0 0x1022e000 0x0 0x1000 0x0 0x10236000 0x0 0x1000>;
	};

	fmem_smi@10238000 {
		compatible = "mediatek,fmem_smi";
		reg = <0x0 0x10238000 0x0 0x1000>;
	};

	gce@10238000 {
		compatible = "mediatek,gce";
		reg = <0x0 0x10238000 0x0 0x1000>;
		interrupts = <0x0 0xa2 0x8 0x0 0xa3 0x8>;
		disp_mutex_reg = <0x14016000 0x1000>;
		g3d_config_base = <0x13000000 0x0 0xffff0000>;
		mmsys_config_base = <0x14000000 0x1 0xffff0000>;
		disp_dither_base = <0x14010000 0x2 0xffff0000>;
		mm_na_base = <0x14020000 0x3 0xffff0000>;
		imgsys_base = <0x15020000 0x4 0xffff0000>;
		vdec_gcon_base = <0x18800000 0x5 0xffff0000>;
		venc_gcon_base = <0x18810000 0x6 0xffff0000>;
		conn_peri_base = <0x18820000 0x7 0xffff0000>;
		topckgen_base = <0x18830000 0x8 0xffff0000>;
		kp_base = <0x18840000 0x9 0xffff0000>;
		scp_sram_base = <0x10000000 0xa 0xffff0000>;
		infra_na3_base = <0x10010000 0xb 0xffff0000>;
		infra_na4_base = <0x10020000 0xc 0xffff0000>;
		scp_base = <0x10030000 0xd 0xffff0000>;
		mcucfg_base = <0x10040000 0xe 0xffff0000>;
		gcpu_base = <0x10050000 0xf 0xffff0000>;
		usb0_base = <0x10200000 0x10 0xffff0000>;
		usb_sif_base = <0x10280000 0x11 0xffff0000>;
		audio_base = <0x17000000 0x12 0xffff0000>;
		vdec_base = <0x17010000 0x13 0xffff0000>;
		msdc2_base = <0x17020000 0x14 0xffff0000>;
		vdec1_base = <0x17030000 0x15 0xffff0000>;
		msdc3_base = <0x18000000 0x16 0xffff0000>;
		ap_dma_base = <0x18010000 0x17 0xffff0000>;
		gce_base = <0x18020000 0x18 0xffff0000>;
		vdec2_base = <0x18040000 0x19 0xffff0000>;
		vdec3_base = <0x18050000 0x1a 0xffff0000>;
		camsys_base = <0x18080000 0x1b 0xffff0000>;
		camsys1_base = <0x180a0000 0x1c 0xffff0000>;
		camsys2_base = <0x180b0000 0x1d 0xffff0000>;
		pwm_sw_base = <0x11000000 0x63 0xffff0000>;
		disp_rdma0_sof = <0x0>;
		disp_rdma1_sof = <0x1>;
		mdp_rdma0_sof = <0x2>;
		mdp_rsz0_sof = <0x4>;
		mdp_rsz1_sof = <0x5>;
		mdp_tdshp_sof = <0x6>;
		mdp_wrot0_sof = <0x7>;
		mdp_wdma_sof = <0x8>;
		disp_ovl0_sof = <0x9>;
		disp_2l_ovl0_sof = <0xa>;
		disp_2l_ovl1_sof = <0xb>;
		disp_wdma0_sof = <0xc>;
		disp_color0_sof = <0xd>;
		disp_ccorr0_sof = <0xe>;
		disp_aal0_sof = <0xf>;
		disp_gamma0_sof = <0x10>;
		disp_dither0_sof = <0x11>;
		disp_pwm0_sof = <0x12>;
		disp_dsi0_sof = <0x13>;
		disp_dpi0_sof = <0x14>;
		disp_rsz0_sof = <0x16>;
		mdp_aal_sof = <0x17>;
		mdp_ccorr_sof = <0x18>;
		disp_dbi0_sof = <0x19>;
		disp_rdma0_frame_done = <0x1a>;
		disp_rdma1_frame_done = <0x1b>;
		mdp_rdma0_frame_done = <0x1c>;
		mdp_rsz0_frame_done = <0x1e>;
		mdp_rsz1_frame_done = <0x1f>;
		mdp_tdshp_frame_done = <0x20>;
		mdp_wrot0_write_frame_done = <0x21>;
		mdp_wdma_frame_done = <0x22>;
		disp_ovl0_frame_done = <0x23>;
		disp_2l_ovl0_frame_done = <0x24>;
		disp_2l_ovl1_frame_done = <0x25>;
		disp_wdma0_frame_done = <0x26>;
		disp_color0_frame_done = <0x27>;
		disp_ccorr0_frame_done = <0x28>;
		disp_aal0_frame_done = <0x29>;
		disp_gamma0_frame_done = <0x2a>;
		disp_dither0_frame_done = <0x2b>;
		disp_dsi0_frame_done = <0x2c>;
		disp_dpi0_frame_done = <0x2d>;
		disp_rsz0_frame_done = <0x2f>;
		mdp_aal_frame_done = <0x30>;
		mdp_ccorr_frame_done = <0x31>;
		disp_dbi0_frame_done = <0x32>;
		stream_done_0 = <0x82>;
		stream_done_1 = <0x83>;
		stream_done_2 = <0x84>;
		stream_done_3 = <0x85>;
		stream_done_4 = <0x86>;
		stream_done_5 = <0x87>;
		stream_done_6 = <0x88>;
		stream_done_7 = <0x89>;
		stream_done_8 = <0x8a>;
		stream_done_9 = <0x8b>;
		stream_done_10 = <0x8c>;
		stream_done_11 = <0x8d>;
		buf_underrun_event_0 = <0x8e>;
		buf_underrun_event_1 = <0x8f>;
		dsi0_te_event = <0x90>;
		dsi0_irq_event = <0x91>;
		dsi0_done_event = <0x92>;
		disp_wdma0_rst_done = <0x96>;
		mdp_wdma_rst_done = <0x97>;
		mdp_wrot0_rst_done = <0x98>;
		mdp_rdma0_rst_done = <0x9a>;
		disp_ovl0_frame_rst_done_pusle = <0x9b>;
		disp_ovl0_2l_frame_rst_done_pusle = <0x9c>;
		disp_ovl1_2l_frame_rst_done_pusle = <0x9d>;
		dip_cq_thread0_frame_done = <0x101>;
		dip_cq_thread1_frame_done = <0x102>;
		dip_cq_thread2_frame_done = <0x103>;
		dip_cq_thread3_frame_done = <0x104>;
		dip_cq_thread4_frame_done = <0x105>;
		dip_cq_thread5_frame_done = <0x106>;
		dip_cq_thread6_frame_done = <0x107>;
		dip_cq_thread7_frame_done = <0x108>;
		dip_cq_thread8_frame_done = <0x109>;
		dip_cq_thread9_frame_done = <0x10a>;
		dip_cq_thread10_frame_done = <0x10b>;
		dip_cq_thread11_frame_done = <0x10c>;
		dip_cq_thread12_frame_done = <0x10d>;
		dip_cq_thread13_frame_done = <0x10e>;
		dip_cq_thread14_frame_done = <0x10f>;
		dip_cq_thread15_frame_done = <0x110>;
		dip_cq_thread16_frame_done = <0x111>;
		dip_cq_thread17_frame_done = <0x112>;
		dip_cq_thread18_frame_done = <0x113>;
		amd_frame_done = <0x114>;
		dve_frame_done = <0x115>;
		wmf_frame_done = <0x116>;
		rsc_frame_done = <0x117>;
		mfb_done = <0x118>;
		wpe_a_frame_done = <0x119>;
		wpe_b_frame_done = <0x11a>;
		occ_done = <0x11b>;
		venc_done = <0x121>;
		jpgenc_done = <0x122>;
		jpgdec_done = <0x123>;
		venc_mb_done = <0x124>;
		venc_128byte_cnt_done = <0x125>;
		isp_frame_done_a = <0x141>;
		isp_frame_done_b = <0x142>;
		camsv_0_pass1_done = <0x143>;
		camsv_1_pass1_done = <0x144>;
		camsv_2_pass1_done = <0x145>;
		tsf_done = <0x146>;
		seninf_0_fifo_full = <0x147>;
		seninf_1_fifo_full = <0x148>;
		seninf_2_fifo_full = <0x149>;
		seninf_3_fifo_full = <0x14a>;
		seninf_4_fifo_full = <0x14b>;
		seninf_5_fifo_full = <0x14c>;
		seninf_6_fifo_full = <0x14d>;
		seninf_7_fifo_full = <0x14e>;
		ipu_done_0 = <0x161>;
		ipu_done_1 = <0x162>;
		ipu_done_2 = <0x163>;
		ipu_done_3 = <0x164>;
		ipu_done_1_0 = <0x181>;
		ipu_done_1_1 = <0x182>;
		ipu_done_1_2 = <0x183>;
		ipu_done_1_3 = <0x184>;
		max_prefetch_cnt = <0x4>;
		prefetch_size = <0xa0 0x20 0x20 0x20>;
		sram_size_cpr_64 = <0x88>;
		mmsys_config = <0x2c>;
		mm_mutex = <0x2d>;
		mdp_rdma0 = <0x2e>;
		mdp_rdma1 = <0x2f>;
		mdp_rsz0 = <0x30>;
		mdp_rsz1 = <0x31>;
		mdp_wrot0 = <0x32>;
		mdp_wdma0 = <0x33>;
		mdp_tdshp0 = <0x34>;
		mdp_aal0 = <0x35>;
		mdp_ccorr0 = <0x36>;
		mdp_color0 = <0x37>;
		venc = <0x38>;
		msdc0 = <0x39>;
		audio = <0x3a>;
		uart = <0x3b>;
		smi_larb0 = <0x3c>;
		sram_share_cnt = <0x1>;
		sram_share_engine = <0x18>;
		sram_share_event = <0x2c6>;
		clocks = <0x15 0x9 0x15 0x19>;
		clock-names = "GCE", "GCE_TIMER";
	};

	gic@1023a000 {
		compatible = "mediatek,gic";
		reg = <0x0 0x1023a000 0x0 0x1000>;
	};

	ap_dma@11000000 {
		compatible = "mediatek,ap_dma";
		reg = <0x0 0x11000000 0x0 0x1000>;
		interrupts = <0x0 0x5e 0x8>;
	};

	auxadc@11001000 {
		compatible = "mediatek,auxadc";
		reg = <0x0 0x11001000 0x0 0x1000>;
		interrupts = <0x0 0x4a 0x2>;
		clocks = <0x15 0x24>;
		clock-names = "auxadc-main";
		linux,phandle = <0x67>;
		phandle = <0x67>;
	};

	dma-controller@11000780 {
		compatible = "mediatek,mt6577-uart-dma";
		reg = <0x0 0x11000780 0x0 0x80 0x0 0x11000800 0x0 0x80 0x0 0x11000880 0x0 0x80 0x0 0x11000900 0x0 0x80 0x0 0x11000980 0x0 0x80 0x0 0x11000a00 0x0 0x80>;
		interrupts = <0x0 0x6c 0x8 0x0 0x6d 0x8 0x0 0x6e 0x8 0x0 0x6f 0x8 0x0 0x70 0x8 0x0 0x71 0x8>;
		clocks = <0x15 0x2b>;
		clock-names = "apdma";
		#dma-cells = <0x1>;
		dma-bits = <0x22>;
		linux,phandle = <0x3e>;
		phandle = <0x3e>;
	};

	serial@11002000 {
		compatible = "mediatek,mt6577-uart";
		reg = <0x0 0x11002000 0x0 0x1000>;
		interrupts = <0x0 0x5b 0x8>;
		clocks = <0x3d 0x15 0x15>;
		clock-names = "baud", "bus";
		dmas = <0x3e 0x0 0x3e 0x1>;
		dma-names = "tx", "rx";
		linux,phandle = <0x3b>;
		phandle = <0x3b>;
	};

	serial@11003000 {
		compatible = "mediatek,mt6577-uart";
		reg = <0x0 0x11003000 0x0 0x1000>;
		interrupts = <0x0 0x5c 0x8>;
		clocks = <0x3d 0x15 0x16>;
		clock-names = "baud", "bus";
		dmas = <0x3e 0x2 0x3e 0x3>;
		dma-names = "tx", "rx";
		linux,phandle = <0x68>;
		phandle = <0x68>;
	};

	serial@11004000 {
		compatible = "mediatek,mt6577-uart";
		reg = <0x0 0x11004000 0x0 0x1000>;
		interrupts = <0x0 0x5d 0x8>;
		clocks = <0x3d 0x15 0x17>;
		clock-names = "baud", "bus";
		dmas = <0x3e 0x4 0x3e 0x5>;
		dma-names = "tx", "rx";
		linux,phandle = <0x69>;
		phandle = <0x69>;
	};

	i2c6@11005000 {
		compatible = "mediatek,i2c6";
		reg = <0x0 0x11005000 0x0 0x1000>;
		interrupts = <0x0 0x57 0x8>;
	};

	pwm@11006000 {
		compatible = "mediatek,pwm";
		reg = <0x0 0x11006000 0x0 0x1000>;
		interrupts = <0x0 0x4b 0x8>;
		clocks = <0x15 0x10 0x15 0x11 0x15 0x12 0x15 0x13 0x15 0xf 0x15 0x14>;
		clock-names = "PWM1-main", "PWM2-main", "PWM3-main", "PWM4-main", "PWM-HCLK-main", "PWM-main";
	};

	spi@1100a000 {
		compatible = "mediatek,mt6771-spi";
		mediatek,pad-select = <0x0>;
		reg = <0x0 0x1100a000 0x0 0x1000>;
		interrupts = <0x0 0x78 0x8>;
		clocks = <0x3f 0x37 0x3f 0x7 0x15 0x1c>;
		clock-names = "parent-clk", "sel-clk", "spi-clk";
		linux,phandle = <0x6a>;
		phandle = <0x6a>;
	};

	spi@11010000 {
		compatible = "mediatek,mt6771-spi";
		mediatek,pad-select = <0x0>;
		reg = <0x0 0x11010000 0x0 0x1000>;
		interrupts = <0x0 0x7c 0x8>;
		clocks = <0x3f 0x37 0x3f 0x7 0x15 0x39>;
		clock-names = "parent-clk", "sel-clk", "spi-clk";
		linux,phandle = <0x6b>;
		phandle = <0x6b>;
	};

	spi@11012000 {
		compatible = "mediatek,mt6771-spi";
		mediatek,pad-select = <0x0>;
		reg = <0x0 0x11012000 0x0 0x1000>;
		interrupts = <0x0 0x81 0x8>;
		clocks = <0x3f 0x37 0x3f 0x7 0x15 0x3c>;
		clock-names = "parent-clk", "sel-clk", "spi-clk";
		linux,phandle = <0x6c>;
		phandle = <0x6c>;
	};

	spi@11013000 {
		compatible = "mediatek,mt6771-spi";
		mediatek,pad-select = <0x0>;
		reg = <0x0 0x11013000 0x0 0x1000>;
		interrupts = <0x0 0x82 0x8>;
		clocks = <0x3f 0x37 0x3f 0x7 0x15 0x3d>;
		clock-names = "parent-clk", "sel-clk", "spi-clk";
		linux,phandle = <0x6d>;
		phandle = <0x6d>;
	};

	spi@11018000 {
		compatible = "mediatek,mt6771-spi";
		mediatek,pad-select = <0x0>;
		reg = <0x0 0x11018000 0x0 0x1000>;
		interrupts = <0x0 0x86 0x8>;
		clocks = <0x3f 0x37 0x3f 0x7 0x15 0x4c>;
		clock-names = "parent-clk", "sel-clk", "spi-clk";
		linux,phandle = <0x6e>;
		phandle = <0x6e>;
	};

	spi@11019000 {
		compatible = "mediatek,mt6771-spi";
		mediatek,pad-select = <0x0>;
		reg = <0x0 0x11019000 0x0 0x1000>;
		interrupts = <0x0 0x87 0x8>;
		clocks = <0x3f 0x37 0x3f 0x7 0x15 0x4d>;
		clock-names = "parent-clk", "sel-clk", "spi-clk";
		linux,phandle = <0x6f>;
		phandle = <0x6f>;
	};

	therm_ctrl@1100b000 {
		compatible = "mediatek,therm_ctrl";
		reg = <0x0 0x1100b000 0x0 0x1000>;
		interrupts = <0x0 0x4c 0x8>;
		clocks = <0x15 0xa>;
		clock-names = "therm-main";
	};

	eem_fsm@1100b000 {
		compatible = "mediatek,eem_fsm";
		reg = <0x0 0x1100b000 0x0 0x1000>;
		interrupts = <0x0 0x7f 0x8>;
	};

	btif@1100c000 {
		compatible = "mediatek,btif";
		reg = <0x0 0x1100c000 0x0 0x1000 0x0 0x11000a80 0x0 0x80 0x0 0x11000b00 0x0 0x80>;
		interrupts = <0x0 0x72 0x8 0x0 0x8b 0x8 0x0 0x8c 0x8>;
		clocks = <0x15 0x1b 0x15 0x2b>;
		clock-names = "btifc", "apdmac";
	};

	consys@18070000 {
		compatible = "mediatek,mt6771-consys";
		reg = <0x0 0x18070000 0x0 0x1000 0x0 0x10007000 0x0 0x100 0x0 0x10001000 0x0 0x1000 0x0 0x10006000 0x0 0x1000>;
		interrupts = <0x0 0x121 0x8 0x0 0x123 0x8>;
		clocks = <0x2b 0x2>;
		clock-names = "conn";
		linux,phandle = <0x28>;
		phandle = <0x28>;
	};

	irtx@1100d000 {
		compatible = "mediatek,irtx";
		reg = <0x0 0x1100d000 0x0 0x1000>;
	};

	irtx_pwm {
		compatible = "mediatek,irtx-pwm";
		pwm_ch = <0x0>;
		pwm_data_invert = <0x0>;
		linux,phandle = <0x70>;
		phandle = <0x70>;
	};

	disp_pwm0@1100e000 {
		compatible = "mediatek,disp_pwm0";
		reg = <0x0 0x1100e000 0x0 0x1000>;
		interrupts = <0x0 0x80 0x8>;
	};

	usb3@11200000 {
		compatible = "mediatek,usb3";
		reg = <0x0 0x11200000 0x0 0x10000 0x0 0x11203e00 0x0 0x100 0x0 0x11f40000 0x0 0x10000>;
		reg-names = "ssusb_base", "ssusb_ippc", "ssusb_sif2";
		interrupts = <0x0 0x48 0x8 0x0 0x49 0x8>;
		interrupt-names = "musb-hdrc", "xhci";
		debug_level = <0x6>;
		fgpa_i2c_physical_base = <0x11009000>;
		linux,phandle = <0x71>;
		phandle = <0x71>;
	};

	usb3_xhci@11200000 {
		compatible = "mediatek,mt67xx-xhci";
		reg = <0x0 0x11200000 0x0 0x10000 0x0 0x11203e00 0x0 0x100>;
		reg-names = "ssusb_base", "ssusb_ippc";
		interrupts = <0x0 0x49 0x8>;
		interrupt-names = "xhci";
		linux,phandle = <0x72>;
		phandle = <0x72>;
	};

	btcvsd@10001000 {
		compatible = "mediatek,audio_bt_cvsd";
		offset = <0xf00 0x800 0xfd0 0xfd4 0xfd8>;
		reg = <0x0 0x10001000 0x0 0x1000 0x0 0x18000000 0x0 0x1000 0x0 0x18080000 0x0 0x10000>;
		interrupts = <0x0 0x120 0x8>;
	};

	audio@11220000 {
		compatible = "mediatek,audio", "syscon";
		reg = <0x0 0x11220000 0x0 0x1000>;
		#clock-cells = <0x1>;
		linux,phandle = <0x3a>;
		phandle = <0x3a>;
	};

	mt_soc_dl1_pcm@11220000 {
		compatible = "mediatek,mt_soc_pcm_dl1";
		reg = <0x0 0x11220000 0x0 0x1000>;
		interrupts = <0x0 0xa1 0x8>;
		clocks = <0x3a 0x9 0x3a 0x3 0x3a 0x2 0x3a 0x4 0x3a 0xe 0x3a 0x8 0x3a 0x7 0x3a 0x5 0x3a 0x6 0x3a 0x1 0x2b 0x8 0x15 0x30 0x15 0x38 0x3f 0xc 0x3f 0xd 0x3f 0x31 0x3f 0x14 0x3f 0x49 0x3f 0x15 0x3f 0x4d 0x3f 0x1f 0x3f 0x4c 0x3f 0x20 0x3f 0x50 0x3d>;
		clock-names = "aud_afe_clk", "aud_dac_clk", "aud_dac_predis_clk", "aud_adc_clk", "aud_adc_adda6_clk", "aud_apll22m_clk", "aud_apll24m_clk", "aud_apll1_tuner_clk", "aud_apll2_tuner_clk", "aud_tml_clk", "scp_sys_audio", "aud_infra_clk", "mtkaif_26m_clk", "top_mux_audio", "top_mux_audio_int", "top_syspll_d2_d4", "top_mux_aud_1", "top_apll1_ck", "top_mux_aud_2", "top_apll2_ck", "top_mux_aud_eng1", "top_apll1_d8", "top_mux_aud_eng2", "top_apll2_d8", "top_clk26m_clk";
		linux,phandle = <0x73>;
		phandle = <0x73>;
	};

	audio_sram@11221000 {
		compatible = "mediatek,audio_sram";
		reg = <0x0 0x11221000 0x0 0xc000>;
	};

	ufshci@11270000 {
		compatible = "mediatek,ufshci";
		reg = <0x0 0x11270000 0x0 0x2300>;
		interrupts = <0x0 0x50 0x8>;
		clocks = <0x15 0x4f 0x15 0x3e 0x15 0x40>;
		clock-names = "ufs0-clock", "ufs0-unipro-clk", "ufs0-mp-clk";
		freq-table-hz = <0x0 0x0 0x0 0x0 0x0 0x0>;
		vcc-supply = <0x14>;
		vcc-fixed-regulator;
		mediatek,auto-hibern8-timer = <0xa>;
		mediatek,spm-level = <0x3>;
		mediatek,rpm-enable = <0x1>;
		mediatek,rpm-autosuspend-delay = <0x7d0>;
		mediatek,rpm-level = <0x3>;
		linux,phandle = <0x74>;
		phandle = <0x74>;
	};

	ca9peri@10e00000 {
		compatible = "mediatek,ca9peri";
		reg = <0x0 0x10e00000 0x0 0x1000>;
	};

	l2c@10f00000 {
		compatible = "mediatek,l2c";
		reg = <0x0 0x10f00000 0x0 0x1000>;
	};

	efusec@11f10000 {
		compatible = "mediatek,efusec";
		reg = <0x0 0x11f10000 0x0 0x1000>;
	};

	ufs_mphy@11fa0000 {
		compatible = "mediatek,ufs_mphy";
		reg = <0x0 0x11fa0000 0x0 0xc000>;
	};

	mfgcfg@13000000 {
		compatible = "mediatek,mfgcfg", "syscon";
		reg = <0x0 0x13000000 0x0 0x1000 0x0 0x10001000 0x0 0x1000 0x0 0x10006000 0x0 0x1000 0x0 0x1020e000 0x0 0x1000 0x0 0xd000000 0x0 0xf0000>;
		#clock-cells = <0x1>;
		linux,phandle = <0x40>;
		phandle = <0x40>;
	};

	mali@13040000 {
		compatible = "mediatek,mali", "arm,mali-midgard", "arm,mali-bifrost";
		reg = <0x0 0x13040000 0x0 0x4000>;
		interrupts = <0x0 0x116 0x8 0x0 0x117 0x8 0x0 0x118 0x8>;
		interrupt-names = "GPU", "MMU", "JOB";
	};

	gpufreq {
		compatible = "mediatek,mt6771-gpufreq";
		clocks = <0x3f 0x4 0x3f 0x61 0x3d 0x40 0x1 0x2b 0x7 0x2b 0x4 0x2b 0xb 0x2b 0xa 0x2b 0xc>;
		clock-names = "clk_mux", "clk_main_parent", "clk_sub_parent", "subsys_mfg_cg", "mtcmos_mfg_async", "mtcmos_mfg", "mtcmos_mfg_core0", "mtcmos_mfg_core1", "mtcmos_mfg_core2";
	};

	mali_tb@1307f000 {
		compatible = "mediatek,mali_tb";
		reg = <0x0 0x1307f000 0x0 0x1000>;
	};

	mfg_dfp_60@13020000 {
		compatible = "mediatek,mfg_dfp_60";
		reg = <0x0 0x13020000 0x0 0x1000>;
		interrupts = <0x0 0x11a 0x8>;
	};

	mfg_tb@13ffef00 {
		compatible = "mediatek,mfg_tb";
		reg = <0x0 0x13ffef00 0x0 0x1000>;
	};

	mmsys_config@14000000 {
		compatible = "mediatek,mmsys_config", "syscon";
		reg = <0x0 0x14000000 0x0 0x1000>;
		interrupts = <0x0 0xef 0x8>;
		#clock-cells = <0x1>;
		clocks = <0x2c 0xb 0x2c 0x25 0x2c 0xc 0x2c 0x26>;
		clock-names = "CAM_MDP_TX", "CAM_MDP_RX", "CAM_MDP2_TX", "CAM_MDP2_RX";
		linux,phandle = <0x2c>;
		phandle = <0x2c>;
	};

	touch {
		compatible = "mediatek,mt6771-touch";
		linux,phandle = <0x75>;
		phandle = <0x75>;
	};

	accdet {
		compatible = "mediatek,pmic-accdet";
		linux,phandle = <0x76>;
		phandle = <0x76>;
	};

	mt6358_gauge {
		compatible = "mediatek,mt6358_gauge";
		gauge_name = "gauge";
		alias_name = "MT6358";
	};

	gauge_timer {
		compatible = "mediatek,gauge_timer_service";
	};

	battery {
		compatible = "mediatek,bat_gm30";
		DIFFERENCE_FULLOCV_ITH = <0xc8>;
		SHUTDOWN_1_TIME = <0x1e>;
		KEEP_100_PERCENT = <0x1>;
		R_FG_VALUE = <0xa>;
		EMBEDDED_SEL = <0x0>;
		PMIC_SHUTDOWN_CURRENT = <0x14>;
		FG_METER_RESISTANCE = <0x4b>;
		CAR_TUNE_VALUE = <0x52>;
		PMIC_MIN_VOL = <0x8598>;
		POWERON_SYSTEM_IBOOT = <0x1f8>;
		SHUTDOWN_GAUGE0_VOLTAGE = <0x84d0>;
		TEMPERATURE_T0 = <0x32>;
		TEMPERATURE_T1 = <0x19>;
		TEMPERATURE_T2 = <0xa>;
		TEMPERATURE_T3 = <0x0>;
		TEMPERATURE_T4 = <0xfffffff6>;
		g_FG_PSEUDO100_T0 = <0x63>;
		g_FG_PSEUDO100_T1 = <0x62>;
		g_FG_PSEUDO100_T2 = <0x62>;
		g_FG_PSEUDO100_T3 = <0x60>;
		g_FG_PSEUDO100_T4 = <0x60>;
		Q_MAX_SYS_VOLTAGE_BAT0 = <0xd16>;
		Q_MAX_SYS_VOLTAGE_BAT1 = <0xd16>;
		Q_MAX_SYS_VOLTAGE_BAT2 = <0xd16>;
		Q_MAX_SYS_VOLTAGE_BAT3 = <0xd16>;
		COM_FG_METER_RESISTANCE = <0x4b>;
		COM_R_FG_VALUE = <0x0>;
		battery0_profile_t0_num = <0x64>;
		battery0_profile_t0_col = <0x3>;
		battery0_profile_t0 = <0x0 0xab62 0x64d 0x1a7 0xaae5 0x64d 0x34e 0xaa6b 0x64d 0x4f4 0xa9f3 0x64c 0x69b 0xa980 0x64c 0x842 0xa90b 0x64c 0x9e9 0xa897 0x64d 0xb90 0xa823 0x64d 0xd36 0xa7ae 0x64c 0xedd 0xa738 0x652 0x1084 0xa6c3 0x654 0x122b 0xa64d 0x654 0x13d2 0xa5d8 0x654 0x1578 0xa565 0x659 0x171f 0xa4f1 0x65b 0x18c6 0xa47c 0x65b 0x1a6d 0xa409 0x65c 0x1c14 0xa396 0x65c 0x1dba 0xa324 0x65e 0x1f61 0xa2b3 0x663 0x2108 0xa242 0x663 0x22af 0xa1d3 0x667 0x2456 0xa165 0x66e 0x25fc 0xa0f7 0x674 0x27a3 0xa08b 0x672 0x294a 0xa020 0x676 0x2af1 0x9fb7 0x67a 0x2c98 0x9f50 0x67d 0x2e3e 0x9eed 0x68e 0x2fe5 0x9e8a 0x696 0x318c 0x9e26 0x69c 0x3333 0x9dc4 0x6a2 0x34da 0x9d63 0x6ad 0x3680 0x9d05 0x6b5 0x3827 0x9caa 0x6c0 0x39ce 0x9c50 0x6d1 0x3b75 0x9bfa 0x6e7 0x3d1c 0x9ba2 0x6f6 0x3ec2 0x9b49 0x705 0x4069 0x9af3 0x71b 0x4210 0x9a95 0x72e 0x43b7 0x9a2f 0x724 0x455e 0x99bf 0x702 0x4704 0x9942 0x6cc 0x48ab 0x98ca 0x693 0x4a52 0x9860 0x66a 0x4bf9 0x9803 0x652 0x4da0 0x97b4 0x64b 0x4f46 0x976c 0x640 0x50ed 0x972a 0x63c 0x5294 0x96ed 0x63d 0x543b 0x96b3 0x63d 0x55e1 0x967c 0x63e 0x5788 0x9647 0x63f 0x592f 0x9614 0x644 0x5ad6 0x95e4 0x651 0x5c7d 0x95b4 0x650 0x5e23 0x9585 0x64f 0x5fca 0x955a 0x654 0x6171 0x952e 0x652 0x6318 0x9508 0x65b 0x64bf 0x94e3 0x667 0x6665 0x94be 0x672 0x680c 0x949a 0x674 0x69b3 0x9478 0x67b 0x6b5a 0x9457 0x687 0x6d01 0x9437 0x69a 0x6ea7 0x941a 0x6a7 0x704e 0x93f9 0x6aa 0x71f5 0x93d4 0x6a6 0x739c 0x93aa 0x69b 0x7543 0x936e 0x67b 0x76e9 0x9329 0x657 0x7890 0x92e5 0x63e 0x7a37 0x92b2 0x64b 0x7bde 0x9286 0x652 0x7d85 0x9258 0x654 0x7f2b 0x922b 0x654 0x80d2 0x91ff 0x654 0x8279 0x91d8 0x64f 0x8420 0x91b3 0x652 0x85c7 0x918f 0x65e 0x876d 0x9168 0x66f 0x8914 0x9132 0x669 0x8abb 0x90f7 0x660 0x8c62 0x90bc 0x65e 0x8e09 0x9087 0x66e 0x8faf 0x903f 0x660 0x9156 0x8ffc 0x64c 0x92fd 0x8fcd 0x63d 0x94a4 0x8fc2 0x64f 0x964b 0x8fb6 0x671 0x97f1 0x8fa8 0x6a1 0x9998 0x8f94 0x6dd 0x9b3f 0x8f5e 0x721 0x9ce6 0x8e8c 0x6eb 0x9e8d 0x8d32 0x6b8 0xa033 0x8b58 0x6e1 0xa1da 0x88a3 0x733 0xa381 0x849e 0x81b>;
		battery0_profile_t1_num = <0x64>;
		battery0_profile_t1_col = <0x3>;
		battery0_profile_t1 = <0x0 0xab33 0x870 0x1a7 0xaab4 0x870 0x34e 0xaa3c 0x87c 0x4f4 0xa9c7 0x889 0x69b 0xa954 0x889 0x842 0xa8dd 0x884 0x9e9 0xa867 0x882 0xb90 0xa7f1 0x880 0xd36 0xa77c 0x87a 0xedd 0xa707 0x87a 0x1084 0xa692 0x87a 0x122b 0xa61d 0x87a 0x13d2 0xa5a7 0x87a 0x1578 0xa534 0x87a 0x171f 0xa4c0 0x87a 0x18c6 0xa44b 0x87b 0x1a6d 0xa3db 0x883 0x1c14 0xa368 0x884 0x1dba 0xa2f6 0x883 0x1f61 0xa286 0x882 0x2108 0xa217 0x888 0x22af 0xa1a8 0x892 0x2456 0xa13b 0x89a 0x25fc 0xa0cf 0x8a0 0x27a3 0xa063 0x8a8 0x294a 0x9ffa 0x8b6 0x2af1 0x9f93 0x8c7 0x2c98 0x9f2e 0x8da 0x2e3e 0x9ece 0x8ea 0x2fe5 0x9e70 0x907 0x318c 0x9e0e 0x91e 0x3333 0x9da2 0x924 0x34da 0x9d34 0x92f 0x3680 0x9ccc 0x93c 0x3827 0x9c6a 0x946 0x39ce 0x9c10 0x94c 0x3b75 0x9bbb 0x95c 0x3d1c 0x9b5e 0x95c 0x3ec2 0x9afb 0x950 0x4069 0x9a91 0x945 0x4210 0x9a1f 0x914 0x43b7 0x99aa 0x8d3 0x455e 0x9937 0x88c 0x4704 0x98c8 0x858 0x48ab 0x986a 0x835 0x4a52 0x9814 0x81f 0x4bf9 0x97c6 0x815 0x4da0 0x9781 0x80f 0x4f46 0x9740 0x80a 0x50ed 0x9702 0x806 0x5294 0x96c6 0x805 0x543b 0x968f 0x807 0x55e1 0x965a 0x807 0x5788 0x9627 0x809 0x592f 0x95f6 0x80b 0x5ad6 0x95c6 0x806 0x5c7d 0x959c 0x812 0x5e23 0x9572 0x81e 0x5fca 0x9546 0x81e 0x6171 0x951f 0x829 0x6318 0x94f9 0x834 0x64bf 0x94d5 0x840 0x6665 0x94b3 0x84d 0x680c 0x948e 0x84b 0x69b3 0x946d 0x853 0x6b5a 0x944e 0x85d 0x6d01 0x942b 0x861 0x6ea7 0x9409 0x863 0x704e 0x93e8 0x864 0x71f5 0x93c7 0x864 0x739c 0x93a2 0x864 0x7543 0x937b 0x858 0x76e9 0x9353 0x849 0x7890 0x9329 0x839 0x7a37 0x92fe 0x830 0x7bde 0x92d4 0x824 0x7d85 0x92ac 0x820 0x7f2b 0x9285 0x826 0x80d2 0x9262 0x82c 0x8279 0x9240 0x836 0x8420 0x9219 0x83e 0x85c7 0x91ec 0x844 0x876d 0x91b3 0x84b 0x8914 0x9179 0x850 0x8abb 0x9141 0x85c 0x8c62 0x9108 0x873 0x8e09 0x90b9 0x878 0x8faf 0x9077 0x87a 0x9156 0x904c 0x88a 0x92fd 0x903e 0x8b2 0x94a4 0x902f 0x8d3 0x964b 0x901b 0x901 0x97f1 0x8ffd 0x940 0x9998 0x8fcf 0x996 0x9b3f 0x8ef7 0x9a4 0x9ce6 0x8d7c 0x9cd 0x9e8d 0x8b69 0xa28 0xa033 0x88c4 0xad4 0xa1da 0x83be 0xd09 0xa381 0x8336 0xd61>;
		battery0_profile_t2_num = <0x64>;
		battery0_profile_t2_col = <0x3>;
		battery0_profile_t2 = <0x0 0xab33 0x870 0x1a7 0xaab4 0x870 0x34e 0xaa3c 0x87c 0x4f4 0xa9c7 0x889 0x69b 0xa954 0x889 0x842 0xa8dd 0x884 0x9e9 0xa867 0x882 0xb90 0xa7f1 0x880 0xd36 0xa77c 0x87a 0xedd 0xa707 0x87a 0x1084 0xa692 0x87a 0x122b 0xa61d 0x87a 0x13d2 0xa5a7 0x87a 0x1578 0xa534 0x87a 0x171f 0xa4c0 0x87a 0x18c6 0xa44b 0x87b 0x1a6d 0xa3db 0x883 0x1c14 0xa368 0x884 0x1dba 0xa2f6 0x883 0x1f61 0xa286 0x882 0x2108 0xa217 0x888 0x22af 0xa1a8 0x892 0x2456 0xa13b 0x89a 0x25fc 0xa0cf 0x8a0 0x27a3 0xa063 0x8a8 0x294a 0x9ffa 0x8b6 0x2af1 0x9f93 0x8c7 0x2c98 0x9f2e 0x8da 0x2e3e 0x9ece 0x8ea 0x2fe5 0x9e70 0x907 0x318c 0x9e0e 0x91e 0x3333 0x9da2 0x924 0x34da 0x9d34 0x92f 0x3680 0x9ccc 0x93c 0x3827 0x9c6a 0x946 0x39ce 0x9c10 0x94c 0x3b75 0x9bbb 0x95c 0x3d1c 0x9b5e 0x95c 0x3ec2 0x9afb 0x950 0x4069 0x9a91 0x945 0x4210 0x9a1f 0x914 0x43b7 0x99aa 0x8d3 0x455e 0x9937 0x88c 0x4704 0x98c8 0x858 0x48ab 0x986a 0x835 0x4a52 0x9814 0x81f 0x4bf9 0x97c6 0x815 0x4da0 0x9781 0x80f 0x4f46 0x9740 0x80a 0x50ed 0x9702 0x806 0x5294 0x96c6 0x805 0x543b 0x968f 0x807 0x55e1 0x965a 0x807 0x5788 0x9627 0x809 0x592f 0x95f6 0x80b 0x5ad6 0x95c6 0x806 0x5c7d 0x959c 0x812 0x5e23 0x9572 0x81e 0x5fca 0x9546 0x81e 0x6171 0x951f 0x829 0x6318 0x94f9 0x834 0x64bf 0x94d5 0x840 0x6665 0x94b3 0x84d 0x680c 0x948e 0x84b 0x69b3 0x946d 0x853 0x6b5a 0x944e 0x85d 0x6d01 0x942b 0x861 0x6ea7 0x9409 0x863 0x704e 0x93e8 0x864 0x71f5 0x93c7 0x864 0x739c 0x93a2 0x864 0x7543 0x937b 0x858 0x76e9 0x9353 0x849 0x7890 0x9329 0x839 0x7a37 0x92fe 0x830 0x7bde 0x92d4 0x824 0x7d85 0x92ac 0x820 0x7f2b 0x9285 0x826 0x80d2 0x9262 0x82c 0x8279 0x9240 0x836 0x8420 0x9219 0x83e 0x85c7 0x91ec 0x844 0x876d 0x91b3 0x84b 0x8914 0x9179 0x850 0x8abb 0x9141 0x85c 0x8c62 0x9108 0x873 0x8e09 0x90b9 0x878 0x8faf 0x9077 0x87a 0x9156 0x904c 0x88a 0x92fd 0x903e 0x8b2 0x94a4 0x902f 0x8d3 0x964b 0x901b 0x901 0x97f1 0x8ffd 0x940 0x9998 0x8fcf 0x996 0x9b3f 0x8ef7 0x9a4 0x9ce6 0x8d7c 0x9cd 0x9e8d 0x8b69 0xa28 0xa033 0x88c4 0xad4 0xa1da 0x83be 0xd09 0xa381 0x8336 0xd61>;
		battery0_profile_t3_num = <0x64>;
		battery0_profile_t3_col = <0x3>;
		battery0_profile_t3 = <0x0 0xaaa1 0x16c6 0x1a7 0xa994 0x16c6 0x34e 0xa845 0x181a 0x4f4 0xa70b 0x19f3 0x69b 0xa649 0x1b68 0x842 0xa5b7 0x1b86 0x9e9 0xa52c 0x1b86 0xb90 0xa4a7 0x1b7f 0xd36 0xa42a 0x1b85 0xedd 0xa3b0 0x1b80 0x1084 0xa339 0x1b7d 0x122b 0xa2c5 0x1b77 0x13d2 0xa252 0x1b59 0x1578 0xa1df 0x1b4c 0x171f 0xa16d 0x1b44 0x18c6 0xa0fc 0x1b3e 0x1a6d 0xa08b 0x1b38 0x1c14 0xa025 0x1b4b 0x1dba 0x9fc4 0x1b6b 0x1f61 0x9f67 0x1b90 0x2108 0x9f05 0x1bae 0x22af 0x9e91 0x1baa 0x2456 0x9e0f 0x1b8a 0x25fc 0x9d81 0x1b52 0x27a3 0x9cf5 0x1b2b 0x294a 0x9c73 0x1b0f 0x2af1 0x9bfa 0x1b06 0x2c98 0x9b8d 0x1b12 0x2e3e 0x9b2a 0x1b16 0x2fe5 0x9ac7 0x1b14 0x318c 0x9a64 0x1b10 0x3333 0x9a01 0x1b0b 0x34da 0x999b 0x1aed 0x3680 0x9936 0x1acb 0x3827 0x98d2 0x1aa9 0x39ce 0x9872 0x1a87 0x3b75 0x9820 0x1a8b 0x3d1c 0x97d3 0x1a98 0x3ec2 0x9787 0x1aa6 0x4069 0x973e 0x1aad 0x4210 0x96fc 0x1ac3 0x43b7 0x96be 0x1ad2 0x455e 0x9683 0x1ade 0x4704 0x964c 0x1ae9 0x48ab 0x9617 0x1af1 0x4a52 0x95e3 0x1afc 0x4bf9 0x95b1 0x1b0a 0x4da0 0x9583 0x1b15 0x4f46 0x9559 0x1b22 0x50ed 0x952f 0x1b23 0x5294 0x9504 0x1b19 0x543b 0x94dc 0x1b13 0x55e1 0x94b9 0x1b2d 0x5788 0x9496 0x1b3c 0x592f 0x9474 0x1b3a 0x5ad6 0x9457 0x1b53 0x5c7d 0x943a 0x1b6e 0x5e23 0x941f 0x1b98 0x5fca 0x9406 0x1bd9 0x6171 0x93ef 0x1c29 0x6318 0x93da 0x1c82 0x64bf 0x93c3 0x1cde 0x6665 0x93aa 0x1d39 0x680c 0x9391 0x1d95 0x69b3 0x9375 0x1de7 0x6b5a 0x9357 0x1e32 0x6d01 0x9339 0x1e7c 0x6ea7 0x9314 0x1ed1 0x704e 0x92ef 0x1f3d 0x71f5 0x92c8 0x1fb9 0x739c 0x929a 0x203d 0x7543 0x9267 0x20d7 0x76e9 0x9234 0x2184 0x7890 0x91fd 0x2240 0x7a37 0x91be 0x2303 0x7bde 0x917e 0x23cf 0x7d85 0x913c 0x24aa 0x7f2b 0x90fb 0x25a2 0x80d2 0x90bd 0x26df 0x8279 0x908d 0x283f 0x8420 0x9063 0x29bd 0x85c7 0x903e 0x2b59 0x876d 0x9016 0x2d15 0x8914 0x8fd5 0x2f16 0x8abb 0x8f63 0x3102 0x8c62 0x8ea9 0x32b3 0x8e09 0x8d42 0x33eb 0x8faf 0x8b2e 0x34e8 0x9156 0x8867 0x3009 0x92fd 0x867b 0x2b3c 0x94a4 0x867b 0x2b3c 0x964b 0x867b 0x2b3c 0x97f1 0x867b 0x2b3c 0x9998 0x867b 0x2b3c 0x9b3f 0x867b 0x2b3c 0x9ce6 0x867b 0x2b3c 0x9e8d 0x867b 0x2b3c 0xa033 0x867b 0x2b3c 0xa1da 0x867b 0x2b3c 0xa381 0x867b 0x2b3c>;
		battery0_profile_t4_num = <0x64>;
		battery0_profile_t4_col = <0x3>;
		battery0_profile_t4 = <0x0 0xaaa1 0x16c6 0x1a7 0xa994 0x16c6 0x34e 0xa845 0x181a 0x4f4 0xa70b 0x19f3 0x69b 0xa649 0x1b68 0x842 0xa5b7 0x1b86 0x9e9 0xa52c 0x1b86 0xb90 0xa4a7 0x1b7f 0xd36 0xa42a 0x1b85 0xedd 0xa3b0 0x1b80 0x1084 0xa339 0x1b7d 0x122b 0xa2c5 0x1b77 0x13d2 0xa252 0x1b59 0x1578 0xa1df 0x1b4c 0x171f 0xa16d 0x1b44 0x18c6 0xa0fc 0x1b3e 0x1a6d 0xa08b 0x1b38 0x1c14 0xa025 0x1b4b 0x1dba 0x9fc4 0x1b6b 0x1f61 0x9f67 0x1b90 0x2108 0x9f05 0x1bae 0x22af 0x9e91 0x1baa 0x2456 0x9e0f 0x1b8a 0x25fc 0x9d81 0x1b52 0x27a3 0x9cf5 0x1b2b 0x294a 0x9c73 0x1b0f 0x2af1 0x9bfa 0x1b06 0x2c98 0x9b8d 0x1b12 0x2e3e 0x9b2a 0x1b16 0x2fe5 0x9ac7 0x1b14 0x318c 0x9a64 0x1b10 0x3333 0x9a01 0x1b0b 0x34da 0x999b 0x1aed 0x3680 0x9936 0x1acb 0x3827 0x98d2 0x1aa9 0x39ce 0x9872 0x1a87 0x3b75 0x9820 0x1a8b 0x3d1c 0x97d3 0x1a98 0x3ec2 0x9787 0x1aa6 0x4069 0x973e 0x1aad 0x4210 0x96fc 0x1ac3 0x43b7 0x96be 0x1ad2 0x455e 0x9683 0x1ade 0x4704 0x964c 0x1ae9 0x48ab 0x9617 0x1af1 0x4a52 0x95e3 0x1afc 0x4bf9 0x95b1 0x1b0a 0x4da0 0x9583 0x1b15 0x4f46 0x9559 0x1b22 0x50ed 0x952f 0x1b23 0x5294 0x9504 0x1b19 0x543b 0x94dc 0x1b13 0x55e1 0x94b9 0x1b2d 0x5788 0x9496 0x1b3c 0x592f 0x9474 0x1b3a 0x5ad6 0x9457 0x1b53 0x5c7d 0x943a 0x1b6e 0x5e23 0x941f 0x1b98 0x5fca 0x9406 0x1bd9 0x6171 0x93ef 0x1c29 0x6318 0x93da 0x1c82 0x64bf 0x93c3 0x1cde 0x6665 0x93aa 0x1d39 0x680c 0x9391 0x1d95 0x69b3 0x9375 0x1de7 0x6b5a 0x9357 0x1e32 0x6d01 0x9339 0x1e7c 0x6ea7 0x9314 0x1ed1 0x704e 0x92ef 0x1f3d 0x71f5 0x92c8 0x1fb9 0x739c 0x929a 0x203d 0x7543 0x9267 0x20d7 0x76e9 0x9234 0x2184 0x7890 0x91fd 0x2240 0x7a37 0x91be 0x2303 0x7bde 0x917e 0x23cf 0x7d85 0x913c 0x24aa 0x7f2b 0x90fb 0x25a2 0x80d2 0x90bd 0x26df 0x8279 0x908d 0x283f 0x8420 0x9063 0x29bd 0x85c7 0x903e 0x2b59 0x876d 0x9016 0x2d15 0x8914 0x8fd5 0x2f16 0x8abb 0x8f63 0x3102 0x8c62 0x8ea9 0x32b3 0x8e09 0x8d42 0x33eb 0x8faf 0x8b2e 0x34e8 0x9156 0x8867 0x3009 0x92fd 0x867b 0x2b3c 0x94a4 0x867b 0x2b3c 0x964b 0x867b 0x2b3c 0x97f1 0x867b 0x2b3c 0x9998 0x867b 0x2b3c 0x9b3f 0x867b 0x2b3c 0x9ce6 0x867b 0x2b3c 0x9e8d 0x867b 0x2b3c 0xa033 0x867b 0x2b3c 0xa1da 0x867b 0x2b3c 0xa381 0x867b 0x2b3c>;
		linux,phandle = <0x77>;
		phandle = <0x77>;
	};

	mdp_rdma0@14001000 {
		compatible = "mediatek,mdp_rdma0";
		reg = <0x0 0x14001000 0x0 0x1000>;
		interrupts = <0x0 0xda 0x8>;
		clocks = <0x2c 0xd>;
		clock-names = "MDP_RDMA0";
		linux,phandle = <0x2e>;
		phandle = <0x2e>;
	};

	mdp_rdma1@14002000 {
		compatible = "mediatek,mdp_rdma1";
		reg = <0x0 0x14002000 0x0 0x1000>;
		interrupts = <0x0 0xdb 0x8>;
		linux,phandle = <0x2f>;
		phandle = <0x2f>;
	};

	mdp_rsz0@14003000 {
		compatible = "mediatek,mdp_rsz0";
		reg = <0x0 0x14003000 0x0 0x1000>;
		interrupts = <0x0 0xdc 0x8>;
		clocks = <0x2c 0xf>;
		clock-names = "MDP_RSZ0";
		linux,phandle = <0x30>;
		phandle = <0x30>;
	};

	mdp_rsz1@14004000 {
		compatible = "mediatek,mdp_rsz1";
		reg = <0x0 0x14004000 0x0 0x1000>;
		interrupts = <0x0 0xdd 0x8>;
		clocks = <0x2c 0x10>;
		clock-names = "MDP_RSZ1";
		linux,phandle = <0x31>;
		phandle = <0x31>;
	};

	mdp_wrot0@14005000 {
		compatible = "mediatek,mdp_wrot0";
		reg = <0x0 0x14005000 0x0 0x1000>;
		interrupts = <0x0 0xdf 0x8>;
		clocks = <0x2c 0x12>;
		clock-names = "MDP_WROT0";
		linux,phandle = <0x32>;
		phandle = <0x32>;
	};

	mdp_wdma@14006000 {
		compatible = "mediatek,mdp_wdma";
		reg = <0x0 0x14006000 0x0 0x1000>;
		interrupts = <0x0 0xe0 0x8>;
		clocks = <0x2c 0x2a>;
		clock-names = "MDP_WDMA";
		linux,phandle = <0x33>;
		phandle = <0x33>;
	};

	mdp_tdshp@14007000 {
		compatible = "mediatek,mdp_tdshp";
		reg = <0x0 0x14007000 0x0 0x1000>;
		interrupts = <0x0 0xde 0x8>;
		clocks = <0x2c 0x11>;
		clock-names = "MDP_TDSHP";
		linux,phandle = <0x34>;
		phandle = <0x34>;
	};

	mtkfb@0 {
		compatible = "mediatek,mtkfb";
		linux,phandle = <0x78>;
		phandle = <0x78>;
	};

	als_ps@0 {
		compatible = "mediatek,als_ps";
		linux,phandle = <0x79>;
		phandle = <0x79>;
	};

	dispsys {
		compatible = "mediatek,dispsys";
		clocks = <0x2b 0x3 0x2c 0x1 0x2c 0x2 0x2c 0x3 0x2c 0x4 0x2c 0x5 0x2c 0x14 0x2c 0x15 0x2c 0x16 0x2c 0x17 0x2c 0x18 0x2c 0x19 0x2c 0x1a 0x2c 0x1b 0x2c 0x1c 0x2c 0x1d 0x2c 0x1e 0x2c 0x20 0x2c 0x21 0x2c 0x22 0x2c 0x23 0x2c 0x2d 0x2c 0x2e 0x2c 0x27 0x2c 0x29 0x3f 0x2 0x3f 0x16 0x15 0x36 0x3d 0x3f 0x43 0x3f 0x44 0x3f 0x5c 0x3f 0x5d 0x3f 0x5f 0x3f 0x12 0x3f 0x52 0x3f 0x53 0x3f 0x54 0x3f 0x55 0x3f 0x51>;
		clock-names = "MMSYS_MTCMOS", "MMSYS_SMI_COMMON", "MMSYS_SMI_LARB0", "MMSYS_SMI_LARB1", "MMSYS_GALS_COMM0", "MMSYS_GALS_COMM1", "MMSYS_DISP_OVL0", "MMSYS_DISP_OVL0_2L", "MMSYS_DISP_OVL1_2L", "MMSYS_DISP_RDMA0", "MMSYS_DISP_RDMA1", "MMSYS_DISP_WDMA0", "MMSYS_DISP_COLOR0", "MMSYS_DISP_CCORR0", "MMSYS_DISP_AAL0", "MMSYS_DISP_GAMMA0", "MMSYS_DISP_DITHER0", "MMSYS_DSI0_MM_CK", "MMSYS_DSI0_IF_CK", "MMSYS_DPI_MM_CK", "MMSYS_DPI_IF_CK", "MMSYS_DBI_MM_CK", "MMSYS_DBI_IF_CK", "MMSYS_26M", "MMSYS_DISP_RSZ", "TOP_MUX_MM", "TOP_MUX_DISP_PWM", "DISP_PWM", "TOP_26M", "TOP_UNIVPLL_D3_D2", "TOP_UNIVPLL_D3_D4", "TOP_OSC_D2", "TOP_OSC_D4", "TOP_OSC_D16", "MUX_DPI0", "TVDPLL_D2", "TVDPLL_D4", "TVDPLL_D8", "TVDPLL_D16", "DPI_CK";
	};

	dsi_te {
		compatible = "mediatek, DSI_TE-eint";
		status = "disabled";
		linux,phandle = <0x7a>;
		phandle = <0x7a>;
	};

	mhl@0 {
		compatible = "mediatek,extd_dev";
		linux,phandle = <0x7b>;
		phandle = <0x7b>;
	};

	disp_ovl0@14008000 {
		compatible = "mediatek,disp_ovl0";
		reg = <0x0 0x14008000 0x0 0x1000>;
		interrupts = <0x0 0xe1 0x8>;
	};

	disp_ovl0_2l@14009000 {
		compatible = "mediatek,disp_ovl0_2l";
		reg = <0x0 0x14009000 0x0 0x1000>;
		interrupts = <0x0 0xe2 0x8>;
	};

	disp_ovl1_2l@1400a000 {
		compatible = "mediatek,disp_ovl1_2l";
		reg = <0x0 0x1400a000 0x0 0x1000>;
		interrupts = <0x0 0xe3 0x8>;
	};

	disp_rdma0@1400b000 {
		compatible = "mediatek,disp_rdma0";
		reg = <0x0 0x1400b000 0x0 0x1000>;
		interrupts = <0x0 0xe4 0x8>;
	};

	disp_rdma1@1400c000 {
		compatible = "mediatek,disp_rdma1";
		reg = <0x0 0x1400c000 0x0 0x1000>;
		interrupts = <0x0 0xe5 0x8>;
	};

	disp_wdma0@1400d000 {
		compatible = "mediatek,disp_wdma0";
		reg = <0x0 0x1400d000 0x0 0x1000>;
		interrupts = <0x0 0xe6 0x8>;
	};

	disp_color0@1400e000 {
		compatible = "mediatek,disp_color0";
		reg = <0x0 0x1400e000 0x0 0x1000>;
		interrupts = <0x0 0xe7 0x8>;
		clocks = <0x2c 0x1a>;
		clock-names = "MDP_COLOR";
		linux,phandle = <0x37>;
		phandle = <0x37>;
	};

	disp_ccorr0@1400f000 {
		compatible = "mediatek,disp_ccorr0";
		reg = <0x0 0x1400f000 0x0 0x1000>;
		interrupts = <0x0 0xe8 0x8>;
	};

	disp_aal0@14010000 {
		compatible = "mediatek,disp_aal0";
		reg = <0x0 0x14010000 0x0 0x1000>;
		interrupts = <0x0 0xe9 0x8>;
		aal_support = <0x1>;
		linux,phandle = <0x7c>;
		phandle = <0x7c>;
	};

	disp_gamma0@14011000 {
		compatible = "mediatek,disp_gamma0";
		reg = <0x0 0x14011000 0x0 0x1000>;
		interrupts = <0x0 0xea 0x8>;
	};

	disp_dither0@14012000 {
		compatible = "mediatek,disp_dither0";
		reg = <0x0 0x14012000 0x0 0x1000>;
		interrupts = <0x0 0xeb 0x8>;
	};

	disp_split@14013000 {
		compatible = "mediatek,disp_split";
		reg = <0x0 0x14013000 0x0 0x1000>;
	};

	dsi0@14014000 {
		compatible = "mediatek,dsi0";
		reg = <0x0 0x14014000 0x0 0x1000>;
		interrupts = <0x0 0xec 0x8>;
	};

	dpi0@14015000 {
		compatible = "mediatek,dpi0";
		reg = <0x0 0x14015000 0x0 0x1000>;
		interrupts = <0x0 0xed 0x8>;
	};

	disp_mutex@14016000 {
		compatible = "mediatek,disp_mutex";
		reg = <0x0 0x14016000 0x0 0x1000>;
		interrupts = <0x0 0xd9 0x8>;
		linux,phandle = <0x2d>;
		phandle = <0x2d>;
	};

	smi_larb0@14017000 {
		compatible = "mediatek,smi_larb0";
		reg = <0x0 0x14017000 0x0 0x1000>;
		interrupts = <0x0 0xf0 0x8>;
		clocks = <0x2b 0x3 0x2c 0x2>;
		clock-names = "mtcmos-mm", "mm-larb0";
		linux,phandle = <0x3c>;
		phandle = <0x3c>;
	};

	smi_common@14019000 {
		compatible = "mediatek,smi_common";
		reg = <0x0 0x14019000 0x0 0x1000>;
		larbs = <0x3c 0x41 0x42 0x43 0x44 0x45 0x46>;
		mmsys_config = <0x2c>;
		clocks = <0x2b 0x3 0x2c 0x4 0x2c 0x5 0x2c 0x1 0x3f 0x2 0x3f 0x3 0x3f 0x23 0x3f 0x2c 0x3f 0x2d 0x3f 0x6f 0x3f 0x70 0x3f 0x40>;
		clock-names = "mtcmos-mm", "smi-common-gals-comm0", "smi-common-gals-comm1", "smi-common", "MMDVFS_CLK_MUX_TOP_MM_SEL", "MMDVFS_CLK_MUX_TOP_CAM_SEL", "MMDVFS_CLK_MUX_TOP_IMG_SEL", "mmdvfs_clk_syspll_d2_ck", "mmdvfs_clk_syspll_d3_ck", "mmdvfs_clk_mmpll_d6_ck", "mmdvfs_clk_mmpll_d7_ck", "mmdvfs_clk_univpll_d2_d2_ck";
	};

	mmdvfs_pmqos {
		compatible = "mediatek,mmdvfs_pmqos";
		mm_step0 = <0x1c2 0x1 0x0 0x6>;
		mm_step1 = <0x138 0x1 0x0 0x7>;
		cam_step0 = <0x222 0x1 0x1 0x3>;
		cam_step1 = <0x16c 0x1 0x1 0x4>;
		img_step0 = <0x20d 0x1 0x2 0x5>;
		img_step1 = <0x16c 0x1 0x2 0x4>;
		vopp_steps = <0x0 0x1>;
		disp_freq = "mm_step0", "mm_step1";
		mdp_freq = "mm_step0", "mm_step1";
		cam_freq = "cam_step0", "cam_step1";
		img_freq = "img_step0", "img_step1";
		vdec_freq = "mm_step0", "mm_step1";
		venc_freq = "mm_step0", "mm_step1";
		clocks = <0x3f 0x2 0x3f 0x3 0x3f 0x23 0x3f 0x2c 0x3f 0x2d 0x3f 0x6f 0x3f 0x70 0x3f 0x40>;
		clock-names = "mmdvfs_clk_mux_top_mm_sel", "mmdvfs_clk_mux_top_cam_sel", "mmdvfs_clk_mux_top_img_sel", "mmdvfs_clk_syspll_d2_ck", "mmdvfs_clk_syspll_d3_ck", "mmdvfs_clk_mmpll_d6_ck", "mmdvfs_clk_mmpll_d7_ck", "mmdvfs_clk_univpll_d2_d2_ck";
	};

	disp_rsz@1401a000 {
		compatible = "mediatek,disp_rsz";
		reg = <0x0 0x1401a000 0x0 0x1000>;
		interrupts = <0x0 0xf1 0x8>;
	};

	mdp_aal@1401b000 {
		compatible = "mediatek,mdp_aal";
		reg = <0x0 0x1401b000 0x0 0x1000>;
		interrupts = <0x0 0xf2 0x8>;
		clocks = <0x2c 0x2b>;
		clock-names = "MDP_AAL";
		linux,phandle = <0x35>;
		phandle = <0x35>;
	};

	mdp_ccorr@1401c000 {
		compatible = "mediatek,mdp_ccorr";
		reg = <0x0 0x1401c000 0x0 0x1000>;
		interrupts = <0x0 0xf3 0x8>;
		clocks = <0x2c 0x2c>;
		clock-names = "MDP_CCORR";
		linux,phandle = <0x36>;
		phandle = <0x36>;
	};

	dbi@1401d000 {
		compatible = "mediatek,dbi";
		reg = <0x0 0x1401d000 0x0 0x1000>;
		interrupts = <0x0 0xf4 0x8>;
	};

	i2c@1401e000 {
		compatible = "mediatek,i2c";
		reg = <0x0 0x1401e000 0x0 0x1000>;
	};

	dsi1@1401f000 {
		compatible = "mediatek,dsi1";
		reg = <0x0 0x1401f000 0x0 0x1000>;
	};

	mdp_wrot1@14020000 {
		compatible = "mediatek,mdp_wrot1";
		reg = <0x0 0x14020000 0x0 0x1000>;
	};

	vdec_gcon@16000000 {
		compatible = "mediatek,vdec_gcon", "syscon";
		reg = <0x0 0x16000000 0x0 0x1000>;
		clocks = <0x2b 0x3 0x2b 0xd 0x2b 0x6 0x47 0x1 0x48 0x2>;
		clock-names = "MT_SCP_SYS_DIS", "MT_SCP_SYS_VDE", "MT_SCP_SYS_VEN", "MT_CG_VDEC", "MT_CG_VENC";
		#clock-cells = <0x1>;
		linux,phandle = <0x47>;
		phandle = <0x47>;
	};

	smi_larb1@16010000 {
		compatible = "mediatek,smi_larb1";
		reg = <0x0 0x16010000 0x0 0x1000>;
		interrupts = <0x0 0x127 0x8>;
		clocks = <0x2b 0xd 0x47 0x1 0x47 0x2>;
		clock-names = "mtcmos-vde", "vdec-vdec", "vdec-larb1";
		linux,phandle = <0x41>;
		phandle = <0x41>;
	};

	vdec@16020000 {
		compatible = "mediatek,vdec";
		reg = <0x0 0x16020000 0x0 0x10000>;
		interrupts = <0x0 0xfa 0x8>;
	};

	vdtop@16020000 {
		compatible = "mediatek,vdtop";
		reg = <0x0 0x16020000 0x0 0x1000>;
	};

	vld@16021000 {
		compatible = "mediatek,vld";
		reg = <0x0 0x16021000 0x0 0x1000>;
	};

	vld_top@16021800 {
		compatible = "mediatek,vld_top";
		reg = <0x0 0x16021800 0x0 0x1000>;
	};

	mc@16022000 {
		compatible = "mediatek,mc";
		reg = <0x0 0x16022000 0x0 0x1000>;
	};

	avc_vld@16023000 {
		compatible = "mediatek,avc_vld";
		reg = <0x0 0x16023000 0x0 0x1000>;
	};

	avc_mv@16024000 {
		compatible = "mediatek,avc_mv";
		reg = <0x0 0x16024000 0x0 0x1000>;
	};

	vdec_pp@16025000 {
		compatible = "mediatek,vdec_pp";
		reg = <0x0 0x16025000 0x0 0x1000>;
	};

	hevc_vld@16028000 {
		compatible = "mediatek,hevc_vld";
		reg = <0x0 0x16028000 0x0 0x1000>;
	};

	vp8_vld@16026800 {
		compatible = "mediatek,vp8_vld";
		reg = <0x0 0x16026800 0x0 0x1000>;
	};

	vp6@16027000 {
		compatible = "mediatek,vp6";
		reg = <0x0 0x16027000 0x0 0x1000>;
	};

	vld2@16027800 {
		compatible = "mediatek,vld2";
		reg = <0x0 0x16027800 0x0 0x1000>;
	};

	mc_vmmu@16028000 {
		compatible = "mediatek,mc_vmmu";
		reg = <0x0 0x16028000 0x0 0x1000>;
	};

	pp_vmmu@16029000 {
		compatible = "mediatek,pp_vmmu";
		reg = <0x0 0x16029000 0x0 0x1000>;
	};

	venc_gcon@17000000 {
		compatible = "mediatek,venc_gcon", "syscon";
		reg = <0x0 0x17000000 0x0 0x1000>;
		#clock-cells = <0x1>;
		linux,phandle = <0x48>;
		phandle = <0x48>;
	};

	smi_larb4@17010000 {
		compatible = "mediatek,smi_larb4";
		reg = <0x0 0x17010000 0x0 0x1000>;
		interrupts = <0x0 0xf8 0x8>;
		clocks = <0x2b 0x6 0x48 0x1 0x48 0x2 0x48 0x3>;
		clock-names = "mtcmos-ven", "venc-larb4", "venc-venc", "venc-jpgenc";
		linux,phandle = <0x44>;
		phandle = <0x44>;
	};

	venc@17020000 {
		compatible = "mediatek,venc";
		reg = <0x0 0x17020000 0x0 0x1000>;
		interrupts = <0x0 0xf7 0x8>;
		linux,phandle = <0x38>;
		phandle = <0x38>;
	};

	venc_jpg@17030000 {
		compatible = "mediatek,venc_jpg";
		reg = <0x0 0x17030000 0x0 0x1000>;
		interrupts = <0x0 0xf9 0x8>;
		clocks = <0x48 0x3>;
		clock-names = "MT_CG_VENC_JPGENC";
	};

	mbist@17040000 {
		compatible = "mediatek,mbist";
		reg = <0x0 0x17040000 0x0 0x1000>;
	};

	mjc_config@12000000 {
		compatible = "mediatek,mjc_config";
		reg = <0x0 0x12000000 0x0 0x1000>;
	};

	mjc_top@12001000 {
		compatible = "mediatek,mjc_top";
		reg = <0x0 0x12001000 0x0 0x1000>;
	};

	imgsys1_dfp@1502e000 {
		compatible = "mediatek,imgsys1_dfp";
		reg = <0x0 0x1502e000 0x0 0x1000>;
	};

	imgsys@15020000 {
		compatible = "mediatek,imgsys", "syscon";
		reg = <0x0 0x15020000 0x0 0x1000>;
		#clock-cells = <0x1>;
		clocks = <0x49 0xa 0x49 0x8>;
		clock-names = "DIP_CG_IMG_LARB5", "DIP_CG_IMG_DIP";
		linux,phandle = <0x49>;
		phandle = <0x49>;
	};

	imgsyscq@15020000 {
		compatible = "mediatek,imgsyscq";
		reg = <0x0 0x15020000 0x0 0x10>;
	};

	smi_larb2@1502f000 {
		compatible = "mediatek,smi_larb2";
		reg = <0x0 0x1502f000 0x0 0x1000>;
		interrupts = <0x0 0x107 0x8>;
		clocks = <0x2b 0x5 0x2c 0xa 0x49 0x9>;
		clock-names = "mtcmos-isp", "gals-ipu2mm", "img-larb2";
		linux,phandle = <0x42>;
		phandle = <0x42>;
	};

	smi_larb5@15021000 {
		compatible = "mediatek,smi_larb5";
		reg = <0x0 0x15021000 0x0 0x1000>;
		interrupts = <0x0 0x10b 0x8>;
		clocks = <0x2b 0x5 0x2c 0x8 0x49 0xa>;
		clock-names = "mtcmos-isp", "gals-img2mm", "img-larb5";
		linux,phandle = <0x45>;
		phandle = <0x45>;
	};

	dip1@15022000 {
		compatible = "mediatek,dip1";
		reg = <0x0 0x15022000 0x0 0x6000>;
		interrupts = <0x0 0x10c 0x8>;
	};

	dip2@15023000 {
		compatible = "mediatek,dip2";
		reg = <0x0 0x15023000 0x0 0x1000>;
	};

	dip3@15024000 {
		compatible = "mediatek,dip3";
		reg = <0x0 0x15024000 0x0 0x1000>;
	};

	dip4@15025000 {
		compatible = "mediatek,dip4";
		reg = <0x0 0x15025000 0x0 0x1000>;
	};

	dip5@15026000 {
		compatible = "mediatek,dip5";
		reg = <0x0 0x15026000 0x0 0x1000>;
	};

	dip6@15027000 {
		compatible = "mediatek,dip6";
		reg = <0x0 0x15027000 0x0 0x1000>;
	};

	dpe@15028000 {
		compatible = "mediatek,dpe";
		reg = <0x0 0x15028000 0x0 0x1000>;
		interrupts = <0x0 0x10e 0x8>;
		clocks = <0x49 0x6>;
		clock-names = "DPE_CG_IMG_DPE";
	};

	dpe_dma@15028000 {
		compatible = "mediatek,dpe_dma";
		reg = <0x0 0x15028000 0x0 0x1000>;
	};

	rsc@15029000 {
		compatible = "mediatek,rsc";
		reg = <0x0 0x15029000 0x0 0x1000>;
		interrupts = <0x0 0x10f 0x8>;
		clocks = <0x49 0x5>;
		clock-names = "RSC_CLK_IMG_RSC";
	};

	wpe_a@1502a000 {
		compatible = "mediatek,wpe_a";
		reg = <0x0 0x1502a000 0x0 0x1000>;
		interrupts = <0x0 0x111 0x8>;
		clocks = <0x49 0x3>;
		clock-names = "WPE_CLK_IMG_WPE_A";
	};

	wpe_b@1502d000 {
		compatible = "mediatek,wpe_b";
		reg = <0x0 0x1502d000 0x0 0x1000>;
		interrupts = <0x0 0x112 0x8>;
		clocks = <0x49 0x2>;
		clock-names = "WPE_CLK_IMG_WPE_B";
	};

	fdvt@1502b000 {
		compatible = "mediatek,fdvt";
		reg = <0x0 0x1502b000 0x0 0x1000>;
		interrupts = <0x0 0x10d 0x8>;
		clocks = <0x49 0x7>;
		clock-names = "FD_CLK_IMG_FDVT";
	};

	fdvt_dma@1502b000 {
		compatible = "mediatek,fdvt_dma";
		reg = <0x0 0x1502b000 0x0 0x1000>;
	};

	mfb@1502e000 {
		compatible = "mediatek,mfb";
		reg = <0x0 0x1502e000 0x0 0x1000>;
		interrupts = <0x0 0x114 0x8>;
		clocks = <0x49 0x4>;
		clock-names = "MFB_CLK_IMG_MFB";
	};

	tsf@1a0a1000 {
		compatible = "mediatek,tsf";
		reg = <0x0 0x1a0a1000 0x0 0x1000>;
		interrupts = <0x0 0x109 0x8>;
		clocks = <0x4a 0x9>;
		clock-names = "TSF_CAMSYS_TSF_CGPDN";
	};

	owe@1502c000 {
		compatible = "mediatek,owe";
		reg = <0x0 0x1502c000 0x0 0x1000>;
		interrupts = <0x0 0x115 0x8>;
		clocks = <0x49 0x1>;
		clock-names = "OWE_CLK_IMG_OWE";
	};

	owe_dma@1502c000 {
		compatible = "mediatek,owe_dma";
		reg = <0x0 0x1502c000 0x0 0x1000>;
	};

	eaf@1502d000 {
		compatible = "mediatek,eaf";
		reg = <0x0 0x1502d000 0x0 0x1000>;
	};

	imgsys1_vad@1502e000 {
		compatible = "mediatek,imgsys1_vad";
		reg = <0x0 0x1502e000 0x0 0x1000>;
	};

	camsys@1a000000 {
		compatible = "mediatek,camsys", "syscon";
		reg = <0x0 0x1a000000 0x0 0x1000>;
		#clock-cells = <0x1>;
		clocks = <0x2b 0x3 0x2b 0x5 0x2b 0x9 0x4a 0x3 0x4a 0x4 0x4a 0x6 0x4a 0x7 0x4a 0x8>;
		clock-names = "ISP_SCP_SYS_DIS", "ISP_SCP_SYS_ISP", "ISP_SCP_SYS_CAM", "CAMSYS_CAM_CGPDN", "CAMSYS_CAMTG_CGPDN", "CAMSYS_CAMSV0_CGPDN", "CAMSYS_CAMSV1_CGPDN", "CAMSYS_CAMSV2_CGPDN";
		linux,phandle = <0x4a>;
		phandle = <0x4a>;
	};

	ipu_conn@19000000 {
		compatible = "mediatek,ipu_conn", "syscon";
		reg = <0x0 0x19000000 0x0 0x1000>;
		#clock-cells = <0x1>;
		linux,phandle = <0x4d>;
		phandle = <0x4d>;
	};

	ipu_adl@19010000 {
		compatible = "mediatek,ipu_adl", "syscon";
		reg = <0x0 0x19010000 0x0 0x1000>;
		#clock-cells = <0x1>;
		linux,phandle = <0x7d>;
		phandle = <0x7d>;
	};

	ipu0@19180000 {
		compatible = "mediatek,ipu0", "syscon";
		reg = <0x0 0x19180000 0x0 0x1000>;
		interrupts = <0x0 0x124 0x8>;
		#clock-cells = <0x1>;
		linux,phandle = <0x4b>;
		phandle = <0x4b>;
	};

	ipu1@19280000 {
		compatible = "mediatek,ipu1", "syscon";
		reg = <0x0 0x19280000 0x0 0x1000>;
		interrupts = <0x0 0x125 0x8>;
		#clock-cells = <0x1>;
		linux,phandle = <0x4c>;
		phandle = <0x4c>;
	};

	vpu_core0@0x19100000 {
		compatible = "mediatek,vpu_core0";
		reg = <0x0 0x19100000 0x0 0x94000>;
		interrupts = <0x0 0x124 0x8>;
		clocks = <0x3f 0x24 0x3f 0x25 0x3f 0x26 0x3f 0x27 0x4b 0x1 0x4b 0x2 0x4b 0x3 0x4c 0x1 0x4c 0x2 0x4c 0x3 0x4d 0x1 0x4d 0x7 0x4d 0x8 0x4d 0x9 0x4d 0xa 0x4d 0xb 0x4d 0xc 0x4d 0xd 0x4d 0xe 0x4d 0xf 0x4d 0x1 0x4d 0x2 0x4d 0x3 0x4d 0x4 0x4d 0x5 0x4d 0x6 0x3f 0x6f 0x3f 0x70 0x3f 0x3d 0x3f 0x2d 0x3f 0x40 0x3f 0x30 0x3f 0x43 0x3f 0x34 0x2c 0xa 0x2c 0x7 0x2c 0x5 0x2c 0x4 0x2c 0x1 0x2b 0x3 0x2b 0xe 0x2b 0xf 0x2b 0x10 0x2b 0x11 0x2b 0x12>;
		clock-names = "clk_top_dsp_sel", "clk_top_dsp1_sel", "clk_top_dsp2_sel", "clk_top_ipu_if_sel", "clk_ipu_core0_jtag_cg", "clk_ipu_core0_axi_m_cg", "clk_ipu_core0_ipu_cg", "clk_ipu_core1_jtag_cg", "clk_ipu_core1_axi_m_cg", "clk_ipu_core1_ipu_cg", "clk_ipu_adl_cabgen", "clk_ipu_conn_dap_rx_cg", "clk_ipu_conn_apb2axi_cg", "clk_ipu_conn_apb2ahb_cg", "clk_ipu_conn_ipu_cab1to2", "clk_ipu_conn_ipu1_cab1to2", "clk_ipu_conn_ipu2_cab1to2", "clk_ipu_conn_cab3to3", "clk_ipu_conn_cab2to1", "clk_ipu_conn_cab3to1_slice", "clk_ipu_conn_ipu_cg", "clk_ipu_conn_ahb_cg", "clk_ipu_conn_axi_cg", "clk_ipu_conn_isp_cg", "clk_ipu_conn_cam_adl_cg", "clk_ipu_conn_img_adl_cg", "clk_top_mmpll_d6", "clk_top_mmpll_d7", "clk_top_univpll_d3", "clk_top_syspll_d3", "clk_top_univpll_d2_d2", "clk_top_syspll_d2_d2", "clk_top_univpll_d3_d2", "clk_top_syspll_d3_d2", "clk_mmsys_gals_ipu2mm", "clk_mmsys_gals_ipu12mm", "clk_mmsys_gals_comm1", "clk_mmsys_gals_comm0", "clk_mmsys_smi_common", "mtcmos_dis", "mtcmos_vpu_top", "mtcmos_vpu_core0_dormant", "mtcmos_vpu_core0_shutdown", "mtcmos_vpu_core1_dormant", "mtcmos_vpu_core1_shutdown";
	};

	vpu_core1@0x19200000 {
		compatible = "mediatek,vpu_core1";
		reg = <0x0 0x19200000 0x0 0x94000>;
		interrupts = <0x0 0x125 0x8>;
	};

	smi_larb3@1a002000 {
		compatible = "mediatek,smi_larb3";
		reg = <0x0 0x1a002000 0x0 0x1000>;
		clocks = <0x2b 0x9 0x2c 0x7 0x4a 0xa>;
		clock-names = "mtcmos-cam", "gals-ipu12mm", "cam-larb3";
		linux,phandle = <0x43>;
		phandle = <0x43>;
	};

	smi_larb6@1a001000 {
		compatible = "mediatek,smi_larb6";
		reg = <0x0 0x1a001000 0x0 0x1000>;
		clocks = <0x2b 0x9 0x2c 0x9 0x4a 0x1>;
		clock-names = "mtcmos-cam", "gals-cam2mm", "cam-larb6";
		linux,phandle = <0x46>;
		phandle = <0x46>;
	};

	cam1@1a003000 {
		compatible = "mediatek,cam1";
		reg = <0x0 0x1a003000 0x0 0x1000>;
		interrupts = <0x0 0xfd 0x8>;
	};

	cam2@1a004000 {
		compatible = "mediatek,cam2";
		reg = <0x0 0x1a004000 0x0 0x2000>;
		interrupts = <0x0 0xfe 0x8>;
	};

	cam3@1a006000 {
		compatible = "mediatek,cam3";
		reg = <0x0 0x1a006000 0x0 0x2000>;
		interrupts = <0x0 0xff 0x8>;
	};

	cam4@1a008000 {
		compatible = "mediatek,cam4";
		reg = <0x0 0x1a008000 0x0 0x2000>;
		interrupts = <0x0 0x100 0x8>;
	};

	camsv1@1a050000 {
		compatible = "mediatek,camsv1";
		reg = <0x0 0x1a050000 0x0 0x1000>;
		interrupts = <0x0 0x102 0x8>;
	};

	camsv2@1a051000 {
		compatible = "mediatek,camsv2";
		reg = <0x0 0x1a051000 0x0 0x1000>;
		interrupts = <0x0 0x103 0x8>;
	};

	camsv3@1a052000 {
		compatible = "mediatek,camsv3";
		reg = <0x0 0x1a052000 0x0 0x1000>;
		interrupts = <0x0 0x104 0x8>;
	};

	camsv4@1a053000 {
		compatible = "mediatek,camsv4";
		reg = <0x0 0x1a053000 0x0 0x1000>;
		interrupts = <0x0 0x105 0x8>;
	};

	camsv5@1a054000 {
		compatible = "mediatek,camsv5";
		reg = <0x0 0x1a054000 0x0 0x1000>;
	};

	camsv6@1a055000 {
		compatible = "mediatek,camsv6";
		reg = <0x0 0x1a055000 0x0 0x1000>;
	};

	seninf1@1a040000 {
		compatible = "mediatek,seninf1";
		reg = <0x0 0x1a040000 0x0 0x1000>;
	};

	seninf2@1a041000 {
		compatible = "mediatek,seninf2";
		reg = <0x0 0x1a041000 0x0 0x1000>;
	};

	seninf3@1a042000 {
		compatible = "mediatek,seninf3";
		reg = <0x0 0x1a042000 0x0 0x1000>;
	};

	seninf4@1a043000 {
		compatible = "mediatek,seninf4";
		reg = <0x0 0x1a043000 0x0 0x1000>;
	};

	seninf5@1a044000 {
		compatible = "mediatek,seninf5";
		reg = <0x0 0x1a044000 0x0 0x1000>;
	};

	seninf6@1a045000 {
		compatible = "mediatek,seninf6";
		reg = <0x0 0x1a045000 0x0 0x1000>;
	};

	seninf7@1a046000 {
		compatible = "mediatek,seninf7";
		reg = <0x0 0x1a046000 0x0 0x1000>;
	};

	seninf8@1a047000 {
		compatible = "mediatek,seninf8";
		reg = <0x0 0x1a047000 0x0 0x1000>;
	};

	seninf_top@1a040000 {
		compatible = "mediatek,seninf_top";
		reg = <0x0 0x1a040000 0x0 0x1000>;
		clocks = <0x2b 0x3 0x2b 0x9 0x4a 0x5 0x3f 0x1c 0x3f 0x5 0x3f 0x1e 0x3f 0x28 0x3f 0x29 0x3d 0x3f 0x65 0x3f 0x45 0x3f 0x64 0x3f 0x60 0x3f 0x66 0x3f 0x67>;
		clock-names = "SCP_SYS_DIS", "SCP_SYS_CAM", "CAMSYS_SENINF_CGPDN", "TOP_MUX_SENINF", "TOP_MUX_CAMTG", "TOP_MUX_CAMTG2", "TOP_MUX_CAMTG3", "TOP_MUX_CAMTG4", "TOP_CLK26M", "TOP_UNIVP_192M_D8", "TOP_UNIVPLL_D3_D8", "TOP_UNIVP_192M_D4", "TOP_F26M_CK_D2", "TOP_UNIVP_192M_D16", "TOP_UNIVP_192M_D32";
	};

	kd_camera_hw1@1a040000 {
		compatible = "mediatek,imgsensor";
		linux,phandle = <0x7e>;
		phandle = <0x7e>;
	};

	hct_device {
		compatible = "mediatek,hct_devices";
		linux,phandle = <0x7f>;
		phandle = <0x7f>;
	};

	flashlight_core {
		compatible = "mediatek,flashlight_core";
		linux,phandle = <0x80>;
		phandle = <0x80>;
	};

	flashlights_lm3642 {
		compatible = "mediatek,flashlights_lm3642";
		decouple = <0x1>;
		linux,phandle = <0x81>;
		phandle = <0x81>;

		channel@1 {
			type = <0x1>;
			ct = <0x0>;
			part = <0x0>;
		};
	};

	flashlights_ha7109 {
		compatible = "mediatek,flashlights_ha7109";
		decouple = <0x1>;
		linux,phandle = <0x82>;
		phandle = <0x82>;

		channel@1 {
			type = <0x1>;
			ct = <0x1>;
			part = <0x0>;
		};
	};

	flashlights_mt6370 {
		compatible = "mediatek,flashlights_mt6370";
		linux,phandle = <0x83>;
		phandle = <0x83>;
	};

	flashlights_rt4509 {
		compatible = "mediatek,flashlights_rt4509";
		decouple = <0x1>;
		linux,phandle = <0x84>;
		phandle = <0x84>;

		channel@1 {
			type = <0x1>;
			ct = <0x0>;
			part = <0x0>;
		};

		channel@2 {
			type = <0x1>;
			ct = <0x1>;
			part = <0x0>;
		};
	};

	ccu@1a0a0000 {
		compatible = "mediatek,ccu";
		reg = <0x0 0x1a0a1000 0x0 0x1000>;
		interrupts = <0x0 0x108 0x8>;
		clocks = <0x4a 0x9 0x2c 0x6>;
		clock-names = "CCU_CLK_CAM_CCU", "CCU_CLK_MMSYS_CCU";
	};

	alc@60000000 {
		compatible = "mediatek,alc";
		reg = <0x0 0x60000000 0x0 0x1000>;
	};

	md_config@80000000 {
		compatible = "mediatek,md_config";
		reg = <0x0 0x80000000 0x0 0x1000>;
	};

	md_uart0@80010000 {
		compatible = "mediatek,md_uart0";
		reg = <0x0 0x80010000 0x0 0x1000>;
	};

	md_p_dma@80020000 {
		compatible = "mediatek,md_p_dma";
		reg = <0x0 0x80020000 0x0 0x1000>;
	};

	md_gpt@80030000 {
		compatible = "mediatek,md_gpt";
		reg = <0x0 0x80030000 0x0 0x1000>;
	};

	simif1@80040000 {
		compatible = "mediatek,simif1";
		reg = <0x0 0x80040000 0x0 0x1000>;
	};

	simif2@80050000 {
		compatible = "mediatek,simif2";
		reg = <0x0 0x80050000 0x0 0x1000>;
	};

	md_peri_misc@80060000 {
		compatible = "mediatek,md_peri_misc";
		reg = <0x0 0x80060000 0x0 0x1000>;
	};

	md_cirq@f0070000 {
		compatible = "mediatek,md_cirq";
		reg = <0x0 0xf0070000 0x0 0x1000>;
	};

	md_debug1@80080000 {
		compatible = "mediatek,md_debug1";
		reg = <0x0 0x80080000 0x0 0x1000>;
	};

	md_debug2@80090000 {
		compatible = "mediatek,md_debug2";
		reg = <0x0 0x80090000 0x0 0x1000>;
	};

	md_debug3@800a0000 {
		compatible = "mediatek,md_debug3";
		reg = <0x0 0x800a0000 0x0 0x1000>;
	};

	mdpar_dbgmon@800b0000 {
		compatible = "mediatek,mdpar_dbgmon";
		reg = <0x0 0x800b0000 0x0 0x1000>;
	};

	md_peri_clk_ctl@800c0000 {
		compatible = "mediatek,md_peri_clk_ctl";
		reg = <0x0 0x800c0000 0x0 0x1000>;
	};

	md_topsm@f00d0000 {
		compatible = "mediatek,md_topsm";
		reg = <0x0 0xf00d0000 0x0 0x1000>;
	};

	md_ost@f00e0000 {
		compatible = "mediatek,md_ost";
		reg = <0x0 0xf00e0000 0x0 0x1000>;
	};

	md_rgu@f00f0000 {
		compatible = "mediatek,md_rgu";
		reg = <0x0 0xf00f0000 0x0 0x1000>;
		interrupts = <0x0 0x11b 0x2>;
	};

	md_i2c@80100000 {
		compatible = "mediatek,md_i2c";
		reg = <0x0 0x80100000 0x0 0x1000>;
	};

	md_eint@80110000 {
		compatible = "mediatek,md_eint";
		reg = <0x0 0x80110000 0x0 0x1000>;
	};

	md_clkctl@80120000 {
		compatible = "mediatek,md_clkctl";
		reg = <0x0 0x80120000 0x0 0x1000>;
	};

	md_global_con_dcm@80130000 {
		compatible = "mediatek,md_global_con_dcm";
		reg = <0x0 0x80130000 0x0 0x1000>;
	};

	md_pll_mixedsys@80140000 {
		compatible = "mediatek,md_pll_mixedsys";
		reg = <0x0 0x80140000 0x0 0x1000>;
	};

	md_clksw@80150000 {
		compatible = "mediatek,md_clksw";
		reg = <0x0 0x80150000 0x0 0x1000>;
	};

	a7_ost@f0160000 {
		compatible = "mediatek,a7_ost";
		reg = <0x0 0xf0160000 0x0 0x1000>;
	};

	md_lite_gpt@80170000 {
		compatible = "mediatek,md_lite_gpt";
		reg = <0x0 0x80170000 0x0 0x1000>;
	};

	mdperi_mbist_config@801a0000 {
		compatible = "mediatek,mdperi_mbist_config";
		reg = <0x0 0x801a0000 0x0 0x1000>;
	};

	md_sdf_top@801b0000 {
		compatible = "mediatek,md_sdf_top";
		reg = <0x0 0x801b0000 0x0 0x1000>;
	};

	psmcu_misc@80200000 {
		compatible = "mediatek,psmcu_misc";
		reg = <0x0 0x80200000 0x0 0x1000>;
	};

	psmcu_busmon@80210000 {
		compatible = "mediatek,psmcu_busmon";
		reg = <0x0 0x80210000 0x0 0x1000>;
	};

	md_pcm@80220000 {
		compatible = "mediatek,md_pcm";
		reg = <0x0 0x80220000 0x0 0x1000>;
	};

	psmcu_mbist_config@80240000 {
		compatible = "mediatek,psmcu_mbist_config";
		reg = <0x0 0x80240000 0x0 0x1000>;
	};

	md_elm@80250000 {
		compatible = "mediatek,md_elm";
		reg = <0x0 0x80250000 0x0 0x1000>;
	};

	md_abm@80260000 {
		compatible = "mediatek,md_abm";
		reg = <0x0 0x80260000 0x0 0x1000>;
	};

	md_soe@80310000 {
		compatible = "mediatek,md_soe";
		reg = <0x0 0x80310000 0x0 0x1000>;
		interrupts = <0x0 0x11e 0x8>;
	};

	md_infra_busmon@80320000 {
		compatible = "mediatek,md_infra_busmon";
		reg = <0x0 0x80320000 0x0 0x1000>;
	};

	md_uart1@80330000 {
		compatible = "mediatek,md_uart1";
		reg = <0x0 0x80330000 0x0 0x1000>;
	};

	md_uart2@80340000 {
		compatible = "mediatek,md_uart2";
		reg = <0x0 0x80340000 0x0 0x1000>;
	};

	mdinfra_mbist_config@80350000 {
		compatible = "mediatek,mdinfra_mbist_config";
		reg = <0x0 0x80350000 0x0 0x1000>;
	};

	mdsys_mbist_config@80360000 {
		compatible = "mediatek,mdsys_mbist_config";
		reg = <0x0 0x80360000 0x0 0x1000>;
	};

	mdsmicfg@803a0000 {
		compatible = "mediatek,mdsmicfg";
		reg = <0x0 0x803a0000 0x0 0x1000>;
	};

	mdinfra_misc@803b0000 {
		compatible = "mediatek,mdinfra_misc";
		reg = <0x0 0x803b0000 0x0 0x1000>;
	};

	md_bus_recoder@803c0000 {
		compatible = "mediatek,md_bus_recoder";
		reg = <0x0 0x803c0000 0x0 0x1000>;
	};

	md_ppc_top@803d0000 {
		compatible = "mediatek,md_ppc_top";
		reg = <0x0 0x803d0000 0x0 0x1000>;
	};

	a7_wdt@f0400000 {
		compatible = "mediatek,a7_wdt";
		reg = <0x0 0xf0400000 0x0 0x1000>;
	};

	a7_mbist_config@f0410000 {
		compatible = "mediatek,a7_mbist_config";
		reg = <0x0 0xf0410000 0x0 0x1000>;
	};

	a7_cirq@f0420000 {
		compatible = "mediatek,a7_cirq";
		reg = <0x0 0xf0420000 0x0 0x1000>;
	};

	pf_bsi_apb1@80200000 {
		compatible = "mediatek,pf_bsi_apb1";
		reg = <0x0 0x80200000 0x0 0x1000>;
	};

	pf_bsi_apb2@80201000 {
		compatible = "mediatek,pf_bsi_apb2";
		reg = <0x0 0x80201000 0x0 0x1000>;
	};

	rfic1_bsispi@80202000 {
		compatible = "mediatek,rfic1_bsispi";
		reg = <0x0 0x80202000 0x0 0x1000>;
	};

	rfic2_bsispi@80203000 {
		compatible = "mediatek,rfic2_bsispi";
		reg = <0x0 0x80203000 0x0 0x1000>;
	};

	mipi0_bsispi@80205000 {
		compatible = "mediatek,mipi0_bsispi";
		reg = <0x0 0x80205000 0x0 0x1000>;
	};

	mipi1_bsispi@80206000 {
		compatible = "mediatek,mipi1_bsispi";
		reg = <0x0 0x80206000 0x0 0x1000>;
	};

	idc_suart@80207000 {
		compatible = "mediatek,idc_suart";
		reg = <0x0 0x80207000 0x0 0x1000>;
	};

	mdm_psys_misc@8020d000 {
		compatible = "mediatek,mdm_psys_misc";
		reg = <0x0 0x8020d000 0x0 0x1000>;
	};

	mdm_psys_mbistcon@8020e000 {
		compatible = "mediatek,mdm_psys_mbistcon";
		reg = <0x0 0x8020e000 0x0 0x1000>;
	};

	md1_abb_mixedsys@8020c000 {
		compatible = "mediatek,md1_abb_mixedsys";
		reg = <0x0 0x8020c000 0x0 0x1000>;
	};

	md2_abb_mixedsys@8020c000 {
		compatible = "mediatek,md2_abb_mixedsys";
		reg = <0x0 0x8020c000 0x0 0x1000>;
	};

	idma@82000000 {
		compatible = "mediatek,idma";
		reg = <0x0 0x82000000 0x0 0x1000>;
	};

	ahb2dspio@82800000 {
		compatible = "mediatek,ahb2dspio";
		reg = <0x0 0x82800000 0x0 0x1000>;
	};

	md2g_confg@82c00000 {
		compatible = "mediatek,md2g_confg";
		reg = <0x0 0x82c00000 0x0 0x1000>;
	};

	apc@82c30000 {
		compatible = "mediatek,apc";
		reg = <0x0 0x82c30000 0x0 0x1000>;
	};

	csd_acc@82c70000 {
		compatible = "mediatek,csd_acc";
		reg = <0x0 0x82c70000 0x0 0x1000>;
	};

	share_d1@82ca0000 {
		compatible = "mediatek,share_d1";
		reg = <0x0 0x82ca0000 0x0 0x1000>;
	};

	irdma@82cb0000 {
		compatible = "mediatek,irdma";
		reg = <0x0 0x82cb0000 0x0 0x1000>;
	};

	patch@82cc0000 {
		compatible = "mediatek,patch";
		reg = <0x0 0x82cc0000 0x0 0x1000>;
	};

	mdafe@82cd0000 {
		compatible = "mediatek,mdafe";
		reg = <0x0 0x82cd0000 0x0 0x1000>;
	};

	bfe@82ce0000 {
		compatible = "mediatek,bfe";
		reg = <0x0 0x82ce0000 0x0 0x1000>;
	};

	modem_lite_confg@83000000 {
		compatible = "mediatek,modem_lite_confg";
		reg = <0x0 0x83000000 0x0 0x1000>;
	};

	modem_lite_topsm@83010000 {
		compatible = "mediatek,modem_lite_topsm";
		reg = <0x0 0x83010000 0x0 0x1000>;
	};

	tdma@83020000 {
		compatible = "mediatek,tdma";
		reg = <0x0 0x83020000 0x0 0x1000>;
	};

	shreg2@83030000 {
		compatible = "mediatek,shreg2";
		reg = <0x0 0x83030000 0x0 0x1000>;
	};

	divider@83040000 {
		compatible = "mediatek,divider";
		reg = <0x0 0x83040000 0x0 0x1000>;
	};

	fcs@83050000 {
		compatible = "mediatek,fcs";
		reg = <0x0 0x83050000 0x0 0x1000>;
	};

	gcu@83060000 {
		compatible = "mediatek,gcu";
		reg = <0x0 0x83060000 0x0 0x1000>;
	};

	bsi_2g@83070000 {
		compatible = "mediatek,bsi_2g";
		reg = <0x0 0x83070000 0x0 0x1000>;
	};

	bpi_2g@83080000 {
		compatible = "mediatek,bpi_2g";
		reg = <0x0 0x83080000 0x0 0x1000>;
	};

	afc_2g@83090000 {
		compatible = "mediatek,afc_2g";
		reg = <0x0 0x83090000 0x0 0x1000>;
	};

	tdd@84000000 {
		compatible = "mediatek,tdd";
		reg = <0x0 0x84000000 0x0 0x1000>;
	};

	l2ulsbdma@85000000 {
		compatible = "mediatek,l2ulsbdma";
		reg = <0x0 0x85000000 0x0 0x1000>;
	};

	l2ulhbdma@85010000 {
		compatible = "mediatek,l2ulhbdma";
		reg = <0x0 0x85010000 0x0 0x1000>;
	};

	l2dlsbdma@85020000 {
		compatible = "mediatek,l2dlsbdma";
		reg = <0x0 0x85020000 0x0 0x1000>;
	};

	l2dlhbdma@85030000 {
		compatible = "mediatek,l2dlhbdma";
		reg = <0x0 0x85030000 0x0 0x1000>;
	};

	l2mbist@85040000 {
		compatible = "mediatek,l2mbist";
		reg = <0x0 0x85040000 0x0 0x1000>;
	};

	l2pseuphy@85050000 {
		compatible = "mediatek,l2pseuphy";
		reg = <0x0 0x85050000 0x0 0x1000>;
	};

	l2hwlog@85058000 {
		compatible = "mediatek,l2hwlog";
		reg = <0x0 0x85058000 0x0 0x1000>;
	};

	l2soindma@85060000 {
		compatible = "mediatek,l2soindma";
		reg = <0x0 0x85060000 0x0 0x1000>;
	};

	l2sooutdma@85070000 {
		compatible = "mediatek,l2sooutdma";
		reg = <0x0 0x85070000 0x0 0x1000>;
	};

	l2ullmac@85080000 {
		compatible = "mediatek,l2ullmac";
		reg = <0x0 0x85080000 0x0 0x1000>;
	};

	l2dllmac@85090000 {
		compatible = "mediatek,l2dllmac";
		reg = <0x0 0x85090000 0x0 0x1000>;
	};

	l2calmac@85098000 {
		compatible = "mediatek,l2calmac";
		reg = <0x0 0x85098000 0x0 0x1000>;
	};

	l2ulfifomng@850a0000 {
		compatible = "mediatek,l2ulfifomng";
		reg = <0x0 0x850a0000 0x0 0x1000>;
	};

	l2dlfifomng@850a4000 {
		compatible = "mediatek,l2dlfifomng";
		reg = <0x0 0x850a4000 0x0 0x1000>;
	};

	l2sofifomng@850a8000 {
		compatible = "mediatek,l2sofifomng";
		reg = <0x0 0x850a8000 0x0 0x1000>;
	};

	l2sec@850b0000 {
		compatible = "mediatek,l2sec";
		reg = <0x0 0x850b0000 0x0 0x1000>;
	};

	l2ulsecctl@850b4000 {
		compatible = "mediatek,l2ulsecctl";
		reg = <0x0 0x850b4000 0x0 0x1000>;
	};

	l2dlsecctl@850b8000 {
		compatible = "mediatek,l2dlsecctl";
		reg = <0x0 0x850b8000 0x0 0x1000>;
	};

	l2sosecctl@850bc000 {
		compatible = "mediatek,l2sosecctl";
		reg = <0x0 0x850bc000 0x0 0x1000>;
	};

	l2misc@850c0000 {
		compatible = "mediatek,l2misc";
		reg = <0x0 0x850c0000 0x0 0x1000>;
	};

	l2ulbuf@850e0000 {
		compatible = "mediatek,l2ulbuf";
		reg = <0x0 0x850e0000 0x0 0x1000>;
	};

	l2dlbuf@850f0000 {
		compatible = "mediatek,l2dlbuf";
		reg = <0x0 0x850f0000 0x0 0x1000>;
	};

	mdl1ao@f60f0000 {
		compatible = "mediatek,mdl1ao";
		reg = <0x0 0xf60f0000 0x0 0x1000>;
	};

	modem_confg@87000000 {
		compatible = "mediatek,modem_confg";
		reg = <0x0 0x87000000 0x0 0x1000>;
	};

	modem_topsm@87010000 {
		compatible = "mediatek,modem_topsm";
		reg = <0x0 0x87010000 0x0 0x1000>;
	};

	bsi_3g@87070000 {
		compatible = "mediatek,bsi_3g";
		reg = <0x0 0x87070000 0x0 0x1000>;
	};

	bpi_3g@87080000 {
		compatible = "mediatek,bpi_3g";
		reg = <0x0 0x87080000 0x0 0x1000>;
	};

	afc_3g@87090000 {
		compatible = "mediatek,afc_3g";
		reg = <0x0 0x87090000 0x0 0x1000>;
	};

	wcdma_timer@870a0000 {
		compatible = "mediatek,wcdma_timer";
		reg = <0x0 0x870a0000 0x0 0x1000>;
	};

	dpa_bc@870b0000 {
		compatible = "mediatek,dpa_bc";
		reg = <0x0 0x870b0000 0x0 0x1000>;
	};

	pfc_encode@870c0000 {
		compatible = "mediatek,pfc_encode";
		reg = <0x0 0x870c0000 0x0 0x1000>;
	};

	pfc_decode@870d0000 {
		compatible = "mediatek,pfc_decode";
		reg = <0x0 0x870d0000 0x0 0x1000>;
	};

	hspasys_1_confg@87200000 {
		compatible = "mediatek,hspasys_1_confg";
		reg = <0x0 0x87200000 0x0 0x1000>;
	};

	hseq@87210000 {
		compatible = "mediatek,hseq";
		reg = <0x0 0x87210000 0x0 0x1000>;
	};

	hsce@87220000 {
		compatible = "mediatek,hsce";
		reg = <0x0 0x87220000 0x0 0x1000>;
	};

	hspasys_1_mbist@87230000 {
		compatible = "mediatek,hspasys_1_mbist";
		reg = <0x0 0x87230000 0x0 0x1000>;
	};

	hspasys_2_confg@87400000 {
		compatible = "mediatek,hspasys_2_confg";
		reg = <0x0 0x87400000 0x0 0x1000>;
	};

	hseq_dc@87410000 {
		compatible = "mediatek,hseq_dc";
		reg = <0x0 0x87410000 0x0 0x1000>;
	};

	hsce_dc@87420000 {
		compatible = "mediatek,hsce_dc";
		reg = <0x0 0x87420000 0x0 0x1000>;
	};

	rake_dc@87430000 {
		compatible = "mediatek,rake_dc";
		reg = <0x0 0x87430000 0x0 0x1000>;
	};

	hspasys_2_mbist@87440000 {
		compatible = "mediatek,hspasys_2_mbist";
		reg = <0x0 0x87440000 0x0 0x1000>;
	};

	uea_uia_u0@87600000 {
		compatible = "mediatek,uea_uia_u0";
		reg = <0x0 0x87600000 0x0 0x1000>;
	};

	uea_uia_u1@87610000 {
		compatible = "mediatek,uea_uia_u1";
		reg = <0x0 0x87610000 0x0 0x1000>;
	};

	dpa_rlc@87620000 {
		compatible = "mediatek,dpa_rlc";
		reg = <0x0 0x87620000 0x0 0x1000>;
	};

	dpa_mac@87630000 {
		compatible = "mediatek,dpa_mac";
		reg = <0x0 0x87630000 0x0 0x1000>;
	};

	upa@f0920000 {
		compatible = "mediatek,upa";
		reg = <0x0 0xf0920000 0x0 0x1000>;
	};

	h_rxbrp@87650000 {
		compatible = "mediatek,h_rxbrp";
		reg = <0x0 0x87650000 0x0 0x1000>;
	};

	rxbrp@87660000 {
		compatible = "mediatek,rxbrp";
		reg = <0x0 0x87660000 0x0 0x1000>;
	};

	hspasys_3_confg@f0910000 {
		compatible = "mediatek,hspasys_3_confg";
		reg = <0x0 0xf0910000 0x0 0x1000>;
	};

	txbrp@87680000 {
		compatible = "mediatek,txbrp";
		reg = <0x0 0x87680000 0x0 0x1000>;
	};

	txcrp@87690000 {
		compatible = "mediatek,txcrp";
		reg = <0x0 0x87690000 0x0 0x1000>;
	};

	h_txbrp@876a0000 {
		compatible = "mediatek,h_txbrp";
		reg = <0x0 0x876a0000 0x0 0x1000>;
	};

	txupc@876b0000 {
		compatible = "mediatek,txupc";
		reg = <0x0 0x876b0000 0x0 0x1000>;
	};

	bc@876c0000 {
		compatible = "mediatek,bc";
		reg = <0x0 0x876c0000 0x0 0x1000>;
	};

	dbg_tx@876d0000 {
		compatible = "mediatek,dbg_tx";
		reg = <0x0 0x876d0000 0x0 0x1000>;
	};

	hspasys_3_mbist@876e0000 {
		compatible = "mediatek,hspasys_3_mbist";
		reg = <0x0 0x876e0000 0x0 0x1000>;
	};

	rxsrp@87800000 {
		compatible = "mediatek,rxsrp";
		reg = <0x0 0x87800000 0x0 0x1000>;
	};

	indec@87810000 {
		compatible = "mediatek,indec";
		reg = <0x0 0x87810000 0x0 0x1000>;
	};

	rake_0@87820000 {
		compatible = "mediatek,rake_0";
		reg = <0x0 0x87820000 0x0 0x1000>;
	};

	rake_1@87830000 {
		compatible = "mediatek,rake_1";
		reg = <0x0 0x87830000 0x0 0x1000>;
	};

	rake_2@87840000 {
		compatible = "mediatek,rake_2";
		reg = <0x0 0x87840000 0x0 0x1000>;
	};

	searcher@87850000 {
		compatible = "mediatek,searcher";
		reg = <0x0 0x87850000 0x0 0x1000>;
	};

	rxdfe@87860000 {
		compatible = "mediatek,rxdfe";
		reg = <0x0 0x87860000 0x0 0x1000>;
	};

	hspasys_4_confg@87870000 {
		compatible = "mediatek,hspasys_4_confg";
		reg = <0x0 0x87870000 0x0 0x1000>;
	};

	dbg@87880000 {
		compatible = "mediatek,dbg";
		reg = <0x0 0x87880000 0x0 0x1000>;
	};

	dwrap0@87890000 {
		compatible = "mediatek,dwrap0";
		reg = <0x0 0x87890000 0x0 0x1000>;
	};

	log3g@878a0000 {
		compatible = "mediatek,log3g";
		reg = <0x0 0x878a0000 0x0 0x1000>;
	};

	hspasys_4_mbist@878b0000 {
		compatible = "mediatek,hspasys_4_mbist";
		reg = <0x0 0x878b0000 0x0 0x1000>;
	};

	dwrap1@878c0000 {
		compatible = "mediatek,dwrap1";
		reg = <0x0 0x878c0000 0x0 0x1000>;
	};

	c2ksys@38000000 {
		compatible = "mediatek,c2ksys";
		reg = <0x0 0x38000000 0x0 0x1000>;
	};

	usbphy {
		compatible = "usb-nop-xceiv";
		linux,phandle = <0x85>;
		phandle = <0x85>;
	};

	usb3_phy {
		compatible = "mediatek,usb3_phy";
		clocks = <0x15 0x5b 0x15 0x3e>;
		clock-names = "ssusb_clk", "sys_ck";
	};

	mt_soc_btcvsd_rx_pcm {
		compatible = "mediatek,mt_soc_btcvsd_rx_pcm";
	};

	mt_soc_btcvsd_tx_pcm {
		compatible = "mediatek,mt_soc_btcvsd_tx_pcm";
	};

	mt_soc_deep_buffer_dl_pcm {
		compatible = "mediatek,mt_soc_pcm_deep_buffer_dl";
	};

	mt_soc_ul1_pcm {
		compatible = "mediatek,mt_soc_pcm_capture";
	};

	mt_soc_voice_md1 {
		compatible = "mediatek,mt_soc_pcm_voice_md1";
	};

	mt_soc_hdmi_pcm {
		compatible = "mediatek,mt_soc_pcm_hdmi";
	};

	mt_soc_uldlloopback_pcm {
		compatible = "mediatek,mt_soc_pcm_uldlloopback";
	};

	mt_soc_i2s0_pcm {
		compatible = "mediatek,mt_soc_pcm_dl1_i2s0";
	};

	mt_soc_mrgrx_pcm {
		compatible = "mediatek,mt_soc_pcm_mrgrx";
	};

	mt_soc_mrgrx_awb_pcm {
		compatible = "mediatek,mt_soc_pcm_mrgrx_awb";
	};

	mt_soc_fm_i2s_pcm {
		compatible = "mediatek,mt_soc_pcm_fm_i2s";
	};

	mt_soc_fm_i2s_awb_pcm {
		compatible = "mediatek,mt_soc_pcm_fm_i2s_awb";
	};

	mt_soc_i2s0dl1_pcm {
		compatible = "mediatek,mt_soc_pcm_dl1_i2s0dl1";
	};

	mt_soc_dl1_awb_pcm {
		compatible = "mediatek,mt_soc_pcm_dl1_awb";
	};

	mt_soc_voice_md1_bt {
		compatible = "mediatek,mt_soc_pcm_voice_md1_bt";
	};

	mt_soc_voip_bt_out {
		compatible = "mediatek,mt_soc_pcm_dl1_bt";
	};

	mt_soc_voip_bt_in {
		compatible = "mediatek,mt_soc_pcm_bt_dai";
	};

	mt_soc_tdmrx_pcm {
		compatible = "mediatek,mt_soc_tdm_capture";
	};

	mt_soc_fm_mrgtx_pcm {
		compatible = "mediatek,mt_soc_pcm_fmtx";
	};

	mt_soc_ul2_pcm {
		compatible = "mediatek,mt_soc_pcm_capture2";
	};

	mt_soc_i2s0_awb_pcm {
		compatible = "mediatek,mt_soc_pcm_i2s0_awb";
	};

	mt_soc_voice_md2 {
		compatible = "mediatek,mt_soc_pcm_voice_md2";
	};

	mt_soc_pcm_dl1_scp_spk {
		compatible = "mediatek,mt_soc_pcm_dl1_scp_spk";
	};

	mt_soc_pcm_voice_scp {
		compatible = "mediatek,mt_soc_pcm_voice_scp";
	};

	mt_soc_routing_pcm {
		compatible = "mediatek,mt_soc_pcm_routing";
	};

	mt_soc_voice_md2_bt {
		compatible = "mediatek,mt_soc_pcm_voice_md2_bt";
	};

	mt_soc_hp_impedance_pcm {
		compatible = "mediatek,mt_soc_pcm_hp_impedance";
	};

	mt_soc_codec_name {
		compatible = "mediatek,mt_soc_codec_63xx";
		use_hp_depop_flow = <0x0>;
		use_ul_260k = <0x0>;
		pcbinfo = <0x1b 0xaf 0x0 0x1b 0x6f 0x0>;
	};

	mt_soc_dummy_pcm {
		compatible = "mediatek,mt_soc_pcm_dummy";
	};

	mt_soc_codec_dummy_name {
		compatible = "mediatek,mt_soc_codec_dummy";
	};

	mt_soc_routing_dai_name {
		compatible = "mediatek,mt_soc_dai_routing";
	};

	mt_soc_dai_name {
		compatible = "mediatek,mt_soc_dai_stub";
	};

	mt_soc_dl2_pcm {
		compatible = "mediatek,mt_soc_pcm_dl2";
	};

	mt_soc_anc_pcm {
		compatible = "mediatek,mt_soc_pcm_anc";
	};

	mt_soc_pcm_voice_ultra {
		compatible = "mediatek,mt_soc_pcm_voice_ultra";
	};

	mt_soc_pcm_voice_usb {
		compatible = "mediatek,mt_soc_pcm_voice_usb";
	};

	mt_soc_pcm_voice_usb_echoref {
		compatible = "mediatek,mt_soc_pcm_voice_usb_echoref";
	};

	mt_soc_vow_barge_in_pcm {
		compatible = "mediatek,mt_soc_pcm_vow_barge_in";
	};

	firmware {

		android {
			compatible = "android,firmware";

			fstab {
				compatible = "android,fstab";

				vendor {
					compatible = "android,vendor";
					dev = "/dev/block/platform/bootdevice/by-name/vendor";
					type = "ext4";
					mnt_flags = "ro";
					fsmgr_flags = "wait,verify";
				};
			};
		};
	};

	odm {
		compatible = "simple-bus";
		linux,phandle = <0x86>;
		phandle = <0x86>;
	};

	radio_md_cfg {
		compatible = "mediatek,radio_md_cfg";
		linux,phandle = <0x87>;
		phandle = <0x87>;
	};

	dynamic_options {
		compatible = "mediatek,dynamic_options";
		linux,phandle = <0x88>;
		phandle = <0x88>;
	};

	mt_charger {
		compatible = "mediatek,mt-charger";
		linux,phandle = <0x89>;
		phandle = <0x89>;
	};

	lk_charger {
		compatible = "mediatek,lk_charger";
		enable_pe_plus;
		power_path_support;
		max_charger_voltage = <0x989680>;
		fast_charge_voltage = <0x2dc6c0>;
		usb_charger_current = <0x7a120>;
		ac_charger_current = <0x1f47d0>;
		ac_charger_input_current = <0x2191c0>;
		non_std_ac_charger_current = <0x19f0a0>;
		charging_host_charger_current = <0x7a120>;
		ta_ac_charger_current = <0x2dc6c0>;
		pd_charger_current = <0x7a120>;
		temp_t4_threshold = <0x32>;
		temp_t3_threshold = <0x2d>;
		temp_t1_threshold = <0x0>;
		linux,phandle = <0x8a>;
		phandle = <0x8a>;
	};

	charger {
		compatible = "mediatek,charger";
		algorithm_name = "SwitchCharging";
		enable_pe_plus;
		enable_pe_2;
		enable_pe_3;
		enable_pe_4;
		enable_type_c;
		power_path_support;
		battery_cv = <0x432380>;
		max_charger_voltage = <0x989680>;
		min_charger_voltage = <0x4630c0>;
		usb_charger_current_suspend = <0x0>;
		usb_charger_current_unconfigured = <0x11170>;
		usb_charger_current_configured = <0x7a120>;
		usb_charger_current = <0x7a120>;
		ac_charger_current = <0x1f47d0>;
		ac_charger_input_current = <0x2191c0>;
		non_std_ac_charger_current = <0x19f0a0>;
		charging_host_charger_current = <0x7a120>;
		apple_1_0a_charger_current = <0x9eb10>;
		apple_2_1a_charger_current = <0xc3500>;
		ta_ac_charger_current = <0x1e8480>;
		jeita_temp_above_t4_cv_voltage = <0x40b280>;
		jeita_temp_t3_to_t4_cv_voltage = <0x40b280>;
		jeita_temp_t2_to_t3_cv_voltage = <0x423920>;
		jeita_temp_t1_to_t2_cv_voltage = <0x40b280>;
		jeita_temp_t0_to_t1_cv_voltage = <0x3da540>;
		jeita_temp_below_t0_cv_voltage = <0x3da540>;
		temp_t4_threshold = <0x32>;
		temp_t4_thres_minus_x_degree = <0x2f>;
		temp_t3_threshold = <0x2d>;
		temp_t3_thres_minus_x_degree = <0x27>;
		temp_t2_threshold = <0xa>;
		temp_t2_thres_plus_x_degree = <0x10>;
		temp_t1_threshold = <0x0>;
		temp_t1_thres_plus_x_degree = <0x6>;
		temp_t0_threshold = <0x0>;
		temp_t0_thres_plus_x_degree = <0x0>;
		temp_neg_10_threshold = <0x0>;
		enable_min_charge_temperature;
		min_charge_temperature = <0xfffffff7>;
		min_charge_temperature_plus_x_degree = <0xfffffff8>;
		max_charge_temperature = <0x37>;
		max_charge_temperature_minus_x_degree = <0x32>;
		pe20_ichg_level_threshold = <0x3e8>;
		ta_start_battery_soc = <0x0>;
		ta_stop_battery_soc = <0x55>;
		pe40_single_charger_input_current = <0x2dc6c0>;
		pe40_single_charger_current = <0x2dc6c0>;
		pe40_dual_charger_input_current = <0x2dc6c0>;
		pe40_dual_charger_chg1_current = <0x1e8480>;
		pe40_dual_charger_chg2_current = <0x1e8480>;
		pe40_stop_battery_soc = <0x50>;
		chg1_ta_ac_charger_current = <0x16e360>;
		chg2_ta_ac_charger_current = <0x16e360>;
		cable_imp_threshold = <0x2bb>;
		vbat_cable_imp_threshold = <0xf3c>;
		bif_threshold1 = <0x40d990>;
		bif_threshold2 = <0x419ce0>;
		bif_cv_under_threshold2 = <0x43e6d0>;
		linux,phandle = <0x8b>;
		phandle = <0x8b>;
	};

	rt9465_slave_chr {
		compatible = "richtek,rt9465";
		linux,phandle = <0x8c>;
		phandle = <0x8c>;
	};

	rt-pd-manager {
		compatible = "mediatek,rt-pd-manager";
	};

	mt6370_pmu_eint {
		linux,phandle = <0x8d>;
		phandle = <0x8d>;
	};

	fingerprint {
		compatible = "mediatek,goodix-fp";
		linux,phandle = <0x8e>;
		phandle = <0x8e>;
	};

	hct_finger {
		compatible = "mediatek,hct_finger";
		linux,phandle = <0x8f>;
		phandle = <0x8f>;
	};

	mt6370_pd_eint {
		linux,phandle = <0x90>;
		phandle = <0x90>;
	};

	scp_dvfs {
		compatible = "mediatek,scp_dvfs";
		clocks = <0x3f 0xf 0x3d 0x3f 0x42 0x3f 0x2e 0x3f 0x30 0x3f 0x40 0x3f 0x2d 0x3f 0x3d>;
		clock-names = "clk_mux", "clk_pll_0", "clk_pll_1", "clk_pll_2", "clk_pll_3", "clk_pll_4", "clk_pll_5", "clk_pll_6";
	};

	rt5081_pmu_eint {
		linux,phandle = <0x91>;
		phandle = <0x91>;
	};

	rt5081_pd_eint {
		linux,phandle = <0x92>;
		phandle = <0x92>;
	};

	pmic_clock_buffer_ctrl {
		compatible = "mediatek,pmic_clock_buffer";
		mediatek,clkbuf-quantity = <0x7>;
		mediatek,clkbuf-config = <0x2 0x1 0x1 0x2 0x0 0x0 0x1>;
		mediatek,clkbuf-driving-current = <0x1 0x1 0x1 0x1 0x1 0x1 0x1>;
		linux,phandle = <0x93>;
		phandle = <0x93>;
	};

	msdc1_ins {
		linux,phandle = <0x94>;
		phandle = <0x94>;
	};

	gyroscope {
		compatible = "mediatek,fix_build_error";
		linux,phandle = <0x95>;
		phandle = <0x95>;
	};

	mse {
		linux,phandle = <0x96>;
		phandle = <0x96>;
	};

	als {
		linux,phandle = <0x97>;
		phandle = <0x97>;
	};

	otg_iddig {
		compatible = "mediatek,usb_iddig_bi_eint";
		linux,phandle = <0x98>;
		phandle = <0x98>;
	};

	nfc {
		compatible = "mediatek,nfc-gpio-v2";
		gpio-rst = <0x13>;
		gpio-rst-std = <0x1b 0x13 0x0>;
		gpio-irq = <0x14>;
		gpio-irq-std = <0x1b 0x14 0x0>;
		linux,phandle = <0x99>;
		phandle = <0x99>;
	};

	irq_nfc {
		compatible = "mediatek,irq_nfc-eint";
		linux,phandle = <0x9a>;
		phandle = <0x9a>;
	};

	ultraviolet {
		compatible = "mediatek,ultraviolet-eint";
		linux,phandle = <0x9b>;
		phandle = <0x9b>;
	};

	heart_rate {
		compatible = "mediatek,heart_rate-eint";
		linux,phandle = <0x9c>;
		phandle = <0x9c>;
	};

	barometer {
		compatible = "mediatek,barometer-eint";
		linux,phandle = <0x9d>;
		phandle = <0x9d>;
	};

	smart_pa {
		linux,phandle = <0x9e>;
		phandle = <0x9e>;
	};

	md1_sim1_hot_plug_eint {
		linux,phandle = <0x9f>;
		phandle = <0x9f>;
	};

	md1_sim2_hot_plug_eint {
		linux,phandle = <0xa0>;
		phandle = <0xa0>;
	};

	usb_c_pinctrl {
		linux,phandle = <0xa1>;
		phandle = <0xa1>;
	};

	ssusb_ip_sleep {
		compatible = "mediatek,usb_ipsleep";
		interrupt-parent = <0x1b>;
		interrupts = <0xb3 0x8 0xbb 0x0>;
		status = "okay";
		linux,phandle = <0xa2>;
		phandle = <0xa2>;
	};

	mt_pmic_regulator {
		compatible = "mediatek,mt_pmic";

		buck_regulators {
			compatible = "mediatek,mt_pmic_buck_regulators";

			buck_vdram1 {
				regulator-name = "vdram1";
				regulator-min-microvolt = <0x7a120>;
				regulator-max-microvolt = <0x1fda4c>;
				regulator-ramp-delay = <0x30d4>;
				regulator-enable-ramp-delay = <0x0>;
				linux,phandle = <0xa3>;
				phandle = <0xa3>;
			};

			buck_vcore {
				regulator-name = "vcore";
				regulator-min-microvolt = <0x7a120>;
				regulator-max-microvolt = <0x13bdb6>;
				regulator-ramp-delay = <0x186a>;
				regulator-enable-ramp-delay = <0xc8>;
				linux,phandle = <0xa4>;
				phandle = <0xa4>;
			};

			buck_vpa {
				regulator-name = "vpa";
				regulator-min-microvolt = <0x7a120>;
				regulator-max-microvolt = <0x37b1d0>;
				regulator-ramp-delay = <0xc350>;
				regulator-enable-ramp-delay = <0xfa>;
				linux,phandle = <0xa5>;
				phandle = <0xa5>;
			};

			buck_vproc11 {
				regulator-name = "vproc11";
				regulator-min-microvolt = <0x7a120>;
				regulator-max-microvolt = <0x13bdb6>;
				regulator-ramp-delay = <0x186a>;
				regulator-enable-ramp-delay = <0xc8>;
				linux,phandle = <0xa6>;
				phandle = <0xa6>;
			};

			buck_vproc12 {
				regulator-name = "vproc12";
				regulator-min-microvolt = <0x7a120>;
				regulator-max-microvolt = <0x13bdb6>;
				regulator-ramp-delay = <0x186a>;
				regulator-enable-ramp-delay = <0xc8>;
				linux,phandle = <0xa7>;
				phandle = <0xa7>;
			};

			buck_vgpu {
				regulator-name = "vgpu";
				regulator-min-microvolt = <0x7a120>;
				regulator-max-microvolt = <0x13bdb6>;
				regulator-ramp-delay = <0x186a>;
				regulator-enable-ramp-delay = <0xc8>;
				linux,phandle = <0xa8>;
				phandle = <0xa8>;
			};

			buck_vs2 {
				regulator-name = "vs2";
				regulator-min-microvolt = <0x7a120>;
				regulator-max-microvolt = <0x1fda4c>;
				regulator-ramp-delay = <0x30d4>;
				regulator-enable-ramp-delay = <0x0>;
				linux,phandle = <0xa9>;
				phandle = <0xa9>;
			};

			buck_vmodem {
				regulator-name = "vmodem";
				regulator-min-microvolt = <0x7a120>;
				regulator-max-microvolt = <0x13bdb6>;
				regulator-ramp-delay = <0x186a>;
				regulator-enable-ramp-delay = <0x384>;
				linux,phandle = <0xaa>;
				phandle = <0xaa>;
			};

			buck_vs1 {
				regulator-name = "vs1";
				regulator-min-microvolt = <0xf4240>;
				regulator-max-microvolt = <0x277b6c>;
				regulator-ramp-delay = <0x30d4>;
				regulator-enable-ramp-delay = <0x0>;
				linux,phandle = <0xab>;
				phandle = <0xab>;
			};
		};

		ldo_regulators {
			compatible = "mediatek,mt_pmic_ldo_regulators";

			ldo_vdram2 {
				regulator-name = "vdram2";
				regulator-min-microvolt = <0x927c0>;
				regulator-max-microvolt = <0x1b7740>;
				regulator-enable-ramp-delay = <0xce4>;
				linux,phandle = <0xac>;
				phandle = <0xac>;
			};

			ldo_vsim1 {
				regulator-name = "vsim1";
				regulator-min-microvolt = <0x19f0a0>;
				regulator-max-microvolt = <0x2f4d60>;
				regulator-enable-ramp-delay = <0x21c>;
				linux,phandle = <0xad>;
				phandle = <0xad>;
			};

			ldo_vibr {
				regulator-name = "vibr";
				regulator-min-microvolt = <0x124f80>;
				regulator-max-microvolt = <0x325aa0>;
				regulator-enable-ramp-delay = <0x3c>;
				linux,phandle = <0xae>;
				phandle = <0xae>;
			};

			ldo_vrf12 {
				compatible = "regulator-fixed";
				regulator-name = "vrf12";
				regulator-min-microvolt = <0x124f80>;
				regulator-max-microvolt = <0x124f80>;
				regulator-enable-ramp-delay = <0x78>;
				linux,phandle = <0xaf>;
				phandle = <0xaf>;
			};

			ldo_vio18 {
				compatible = "regulator-fixed";
				regulator-name = "vio18";
				regulator-min-microvolt = <0x1b7740>;
				regulator-max-microvolt = <0x1b7740>;
				regulator-enable-ramp-delay = <0xa8c>;
				linux,phandle = <0xb0>;
				phandle = <0xb0>;
			};

			ldo_vusb {
				regulator-name = "vusb";
				regulator-min-microvolt = <0x2dc6c0>;
				regulator-max-microvolt = <0x2f4d60>;
				regulator-enable-ramp-delay = <0x10e>;
				linux,phandle = <0xb1>;
				phandle = <0xb1>;
			};

			ldo_vcamio {
				compatible = "regulator-fixed";
				regulator-name = "vcamio";
				regulator-min-microvolt = <0x1b7740>;
				regulator-max-microvolt = <0x1b7740>;
				regulator-enable-ramp-delay = <0x10e>;
				linux,phandle = <0xb2>;
				phandle = <0xb2>;
			};

			ldo_vcamd {
				regulator-name = "vcamd";
				regulator-min-microvolt = <0xdbba0>;
				regulator-max-microvolt = <0x1b7740>;
				regulator-enable-ramp-delay = <0x10e>;
				linux,phandle = <0xb3>;
				phandle = <0xb3>;
			};

			ldo_vcn18 {
				compatible = "regulator-fixed";
				regulator-name = "vcn18";
				regulator-min-microvolt = <0x1b7740>;
				regulator-max-microvolt = <0x1b7740>;
				regulator-enable-ramp-delay = <0x10e>;
				linux,phandle = <0xb4>;
				phandle = <0xb4>;
			};

			ldo_vfe28 {
				compatible = "regulator-fixed";
				regulator-name = "vfe28";
				regulator-min-microvolt = <0x2ab980>;
				regulator-max-microvolt = <0x2ab980>;
				regulator-enable-ramp-delay = <0x10e>;
				linux,phandle = <0xb5>;
				phandle = <0xb5>;
			};

			ldo_vsram_proc11 {
				regulator-name = "vsram_proc11";
				regulator-min-microvolt = <0x7a120>;
				regulator-max-microvolt = <0x13bdb6>;
				regulator-ramp-delay = <0x186a>;
				regulator-enable-ramp-delay = <0xf0>;
				linux,phandle = <0xb6>;
				phandle = <0xb6>;
			};

			ldo_vcn28 {
				compatible = "regulator-fixed";
				regulator-name = "vcn28";
				regulator-min-microvolt = <0x2ab980>;
				regulator-max-microvolt = <0x2ab980>;
				regulator-enable-ramp-delay = <0x10e>;
				linux,phandle = <0xb7>;
				phandle = <0xb7>;
			};

			ldo_vsram_others {
				regulator-name = "vsram_others";
				regulator-min-microvolt = <0x7a120>;
				regulator-max-microvolt = <0x13bdb6>;
				regulator-ramp-delay = <0x186a>;
				regulator-enable-ramp-delay = <0xf0>;
				linux,phandle = <0xb8>;
				phandle = <0xb8>;
			};

			ldo_vsram_gpu {
				regulator-name = "vsram_gpu";
				regulator-min-microvolt = <0x7a120>;
				regulator-max-microvolt = <0x13bdb6>;
				regulator-ramp-delay = <0x186a>;
				regulator-enable-ramp-delay = <0xf0>;
				linux,phandle = <0xb9>;
				phandle = <0xb9>;
			};

			ldo_vxo22 {
				compatible = "regulator-fixed";
				regulator-name = "vxo22";
				regulator-min-microvolt = <0x2191c0>;
				regulator-max-microvolt = <0x2191c0>;
				regulator-enable-ramp-delay = <0x78>;
				linux,phandle = <0xba>;
				phandle = <0xba>;
			};

			ldo_vefuse {
				regulator-name = "vefuse";
				regulator-min-microvolt = <0x19f0a0>;
				regulator-max-microvolt = <0x1cfde0>;
				regulator-enable-ramp-delay = <0x10e>;
				linux,phandle = <0xbb>;
				phandle = <0xbb>;
			};

			ldo_vaux18 {
				compatible = "regulator-fixed";
				regulator-name = "vaux18";
				regulator-min-microvolt = <0x1b7740>;
				regulator-max-microvolt = <0x1b7740>;
				regulator-enable-ramp-delay = <0x10e>;
				linux,phandle = <0xbc>;
				phandle = <0xbc>;
			};

			ldo_vmch {
				regulator-name = "vmch";
				regulator-min-microvolt = <0x2c4020>;
				regulator-max-microvolt = <0x325aa0>;
				regulator-enable-ramp-delay = <0x3c>;
				linux,phandle = <0x1c>;
				phandle = <0x1c>;
			};

			ldo_vbif28 {
				compatible = "regulator-fixed";
				regulator-name = "vbif28";
				regulator-min-microvolt = <0x2ab980>;
				regulator-max-microvolt = <0x2ab980>;
				regulator-enable-ramp-delay = <0x10e>;
				linux,phandle = <0xbd>;
				phandle = <0xbd>;
			};

			ldo_vsram_proc12 {
				regulator-name = "vsram_proc12";
				regulator-min-microvolt = <0x7a120>;
				regulator-max-microvolt = <0x13bdb6>;
				regulator-ramp-delay = <0x186a>;
				regulator-enable-ramp-delay = <0xf0>;
				linux,phandle = <0xbe>;
				phandle = <0xbe>;
			};

			ldo_vcama1 {
				regulator-name = "vcama1";
				regulator-min-microvolt = <0x1b7740>;
				regulator-max-microvolt = <0x2dc6c0>;
				regulator-enable-ramp-delay = <0x10e>;
				linux,phandle = <0xbf>;
				phandle = <0xbf>;
			};

			ldo_vemc {
				regulator-name = "vemc";
				regulator-min-microvolt = <0x2c4020>;
				regulator-max-microvolt = <0x325aa0>;
				regulator-enable-ramp-delay = <0x3c>;
				linux,phandle = <0x14>;
				phandle = <0x14>;
			};

			ldo_vio28 {
				compatible = "regulator-fixed";
				regulator-name = "vio28";
				regulator-min-microvolt = <0x2ab980>;
				regulator-max-microvolt = <0x2ab980>;
				regulator-enable-ramp-delay = <0x10e>;
				linux,phandle = <0xc0>;
				phandle = <0xc0>;
			};

			ldo_va12 {
				compatible = "regulator-fixed";
				regulator-name = "va12";
				regulator-min-microvolt = <0x124f80>;
				regulator-max-microvolt = <0x124f80>;
				regulator-enable-ramp-delay = <0x10e>;
				linux,phandle = <0xc1>;
				phandle = <0xc1>;
			};

			ldo_vrf18 {
				compatible = "regulator-fixed";
				regulator-name = "vrf18";
				regulator-min-microvolt = <0x1b7740>;
				regulator-max-microvolt = <0x1b7740>;
				regulator-enable-ramp-delay = <0x78>;
				linux,phandle = <0xc2>;
				phandle = <0xc2>;
			};

			ldo_vcn33_bt {
				regulator-name = "vcn33_bt";
				regulator-min-microvolt = <0x325aa0>;
				regulator-max-microvolt = <0x3567e0>;
				regulator-enable-ramp-delay = <0x10e>;
				linux,phandle = <0xc3>;
				phandle = <0xc3>;
			};

			ldo_vcn33_wifi {
				regulator-name = "vcn33_wifi";
				regulator-min-microvolt = <0x325aa0>;
				regulator-max-microvolt = <0x3567e0>;
				regulator-enable-ramp-delay = <0x10e>;
				linux,phandle = <0xc4>;
				phandle = <0xc4>;
			};

			ldo_vcama2 {
				regulator-name = "vcama2";
				regulator-min-microvolt = <0x1b7740>;
				regulator-max-microvolt = <0x2dc6c0>;
				regulator-enable-ramp-delay = <0x10e>;
				linux,phandle = <0xc5>;
				phandle = <0xc5>;
			};

			ldo_vmc {
				regulator-name = "vmc";
				regulator-min-microvolt = <0x1b7740>;
				regulator-max-microvolt = <0x325aa0>;
				regulator-enable-ramp-delay = <0x3c>;
				linux,phandle = <0x1d>;
				phandle = <0x1d>;
			};

			ldo_vldo28 {
				regulator-name = "vldo28";
				regulator-min-microvolt = <0x2ab980>;
				regulator-max-microvolt = <0x2dc6c0>;
				regulator-enable-ramp-delay = <0x10e>;
				linux,phandle = <0xc6>;
				phandle = <0xc6>;
			};

			ldo_vaud28 {
				compatible = "regulator-fixed";
				regulator-name = "vaud28";
				regulator-min-microvolt = <0x2ab980>;
				regulator-max-microvolt = <0x2ab980>;
				regulator-enable-ramp-delay = <0x10e>;
				linux,phandle = <0xc7>;
				phandle = <0xc7>;
			};

			ldo_vsim2 {
				regulator-name = "vsim2";
				regulator-min-microvolt = <0x19f0a0>;
				regulator-max-microvolt = <0x2f4d60>;
				regulator-enable-ramp-delay = <0x21c>;
				linux,phandle = <0xc8>;
				phandle = <0xc8>;
			};

			ldo_va09 {
				compatible = "regulator-fixed";
				regulator-name = "va09";
				regulator-min-microvolt = <0xdbba0>;
				regulator-max-microvolt = <0xdbba0>;
				regulator-enable-ramp-delay = <0x108>;
				regulator-boot-on;
				linux,phandle = <0xc9>;
				phandle = <0xc9>;
			};
		};
	};

	mt6370_pmu_dts {
		interrupt-controller;
		#interrupt-cells = <0x1>;
		mt6370,intr_gpio_num = <0xa>;
		mt6370,intr_gpio = <0x1b 0xa 0x0>;
		linux,phandle = <0xca>;
		phandle = <0xca>;

		core {
			compatible = "mediatek,mt6370_pmu_core";
			interrupt-names = "otp", "vdda_ovp", "vdda_uv";
			i2cstmr_rst_tmr = <0x0>;
			mrstb_en;
			mrstb_tmr = <0x3>;
			int_wdt = <0x0>;
			int_deg = <0x0>;
		};

		charger {
			compatible = "mediatek,mt6370_pmu_charger";
			interrupt-names = "chg_mivr", "chg_aiclmeasi", "attachi", "ovpctrl_uvp_d_evt", "chg_wdtmri", "chg_vbusov", "chg_tmri", "chg_treg";
			charger_name = "primary_chg";
			load_switch_name = "secondary_load_switch";
			ichg = <0x1e8480>;
			aicr = <0x7a120>;
			mivr = <0x432380>;
			cv = <0x432380>;
			ieoc = <0x249f0>;
			safety_timer = <0xc>;
			dc_wdt = <0x3d0900>;
			ircmp_resistor = <0x61a8>;
			ircmp_vclamp = <0x7d00>;
			enable_te;
			enable_wdt;
		};

		mt6370_pmu_fled1 {
			compatible = "mediatek,mt6370_pmu_fled1";
			interrupt-names = "fled_lvf", "fled2_short", "fled1_short";
			fled_enable = <0x1>;
			torch_cur = <0x493e0>;
			strobe_cur = <0x124f80>;
			strobe_timeout = <0x960>;
		};

		mt6370_pmu_fled2 {
			compatible = "mediatek,mt6370_pmu_fled2";
			fled_enable = <0x1>;
			torch_cur = <0x30d40>;
			strobe_cur = <0xf4240>;
			strobe_timeout = <0x4b0>;
		};

		ldo {
			compatible = "mediatek,mt6370_pmu_ldo";
			interrupt-names = "ldo_oc";
			ldo_oms = <0x1>;
			ldo_vrc_lt = <0x1>;

			mt6370_ldo {
				regulator-name = "irtx_ldo";
				regulator-min-microvolt = <0x186a00>;
				regulator-max-microvolt = <0x3d0900>;
			};
		};

		rgbled {
			compatible = "mediatek,mt6370_pmu_rgbled";
			interrupt-names = "isink4_short", "isink3_short", "isink2_short", "isink1_short", "isink4_open", "isink3_open", "isink2_open", "isink1_open";
			mt,led_name = "mt6370_pmu_led1", "blue", "green", "red";
			mt,led_default_trigger = "cc_mode", "cc_mode", "cc_mode", "cc_mode";
		};

		bled {
			compatible = "mediatek,mt6370_pmu_bled";
			interrupt-names = "bled_ocp";
			mt,bled_name = "mt6370_pmu_bled";
			mt,chan_en = <0x3>;
			mt,map_linear;
			mt,bl_ovp_level = <0x3>;
			mt,bl_ocp_level = <0x2>;
			mt,use_pwm;
			mt,pwm_fsample = <0x2>;
			mt,pwm_deglitch = <0x1>;
			mt,pwm_avg_cycle = <0x0>;
			mt,bled_ramptime = <0x3>;
			mt,bled_flash_ramp = <0x1>;
			mt,max_bled_brightness = <0x55a>;
		};

		dsv {
			compatible = "mediatek,mt6370_pmu_dsv";
			interrupt-names = "dsv_vneg_ocp", "dsv_vpos_ocp", "dsv_bst_ocp", "dsv_vneg_scp", "dsv_vpos_scp";
			db_ext_en = <0x0>;
			db_periodic_fix = <0x0>;
			db_single_pin = <0x0>;
			db_freq_pm = <0x0>;
			db_periodic_mode = <0x0>;
			db_startup = <0x0>;
			db_vneg_20ms = <0x0>;
			db_vneg_disc = <0x1>;
			db_vpos_20ms = <0x0>;
			db_vpos_disc = <0x1>;
			db_delay = <0x3>;
			db_vbst = <0x17a2>;
			db_vpos_slew = <0x1>;
			db_vneg_slew = <0x1>;

			mt6370_dsvp {
				regulator-name = "dsv_pos";
				regulator-min-microvolt = <0x3d0900>;
				regulator-max-microvolt = <0x5b8d80>;
			};

			mt6370_dsvn {
				regulator-name = "dsv_neg";
				regulator-min-microvolt = <0x3d0900>;
				regulator-max-microvolt = <0x5b8d80>;
			};
		};
	};

	type_c_port0 {
		tcpc-dual,supported_modes = <0x0>;
		mt-tcpc,name = "type_c_port0";
		mt-tcpc,role_def = <0x4>;
		mt-tcpc,rp_level = <0x0>;
		mt-tcpc,vconn_supply = <0x1>;
		mt-tcpc,notifier_supply_num = <0x3>;
		mt6370pd,intr_gpio = <0x1b 0x8 0x0>;
		mt6370pd,intr_gpio_num = <0x8>;
		linux,phandle = <0xcb>;
		phandle = <0xcb>;

		pd-data {
			pd,vid = <0x29cf>;
			pd,pid = <0x5081>;
			pd,source-cap-ext = <0x171129cf 0x0 0x102 0x0 0x0 0x2000000>;
			pd,mfrs = "RichtekTCPC";
			pd,charging_policy = <0x21>;
			pd,source-pdo-size = <0x1>;
			pd,source-pdo-data = <0x19032>;
			pd,sink-pdo-size = <0x2>;
			pd,sink-pdo-data = <0x190c8 0xc0761e3c>;
			pd,id-vdo-size = <0x3>;
			pd,id-vdo-data = <0xd10029cf 0x0 0x10000>;
			bat,nr = <0x1>;
			pd,country_nr = <0x0>;

			bat-info0 {
				bat,vid = <0x29cf>;
				bat,pid = <0x1711>;
				bat,mfrs = "bat1";
				bat,design_cap = <0xbb8>;
			};
		};

		dpm_caps {
			local_dr_power;
			local_dr_data;
			local_usb_comm;
			local_no_suspend;
			local_vconn_supply;
			attemp_enter_dp_mode;
			attemp_discover_cable;
			attemp_discover_id;
			pr_check = <0x0>;
			pr_check_gp_source;
			dr_check = <0x0>;
		};
	};

	__symbols__ {
		chosen = "/chosen";
		cpu0 = "/cpus/cpu@000";
		cpu1 = "/cpus/cpu@001";
		cpu2 = "/cpus/cpu@002";
		cpu3 = "/cpus/cpu@003";
		cpu4 = "/cpus/cpu@100";
		cpu5 = "/cpus/cpu@101";
		cpu6 = "/cpus/cpu@102";
		cpu7 = "/cpus/cpu@103";
		STANDBY = "/cpus/idle-states/standby";
		MCDI_CPU = "/cpus/idle-states/mcdi-cpu";
		MCDI_CLUSTER = "/cpus/idle-states/mcdi-cluster";
		SODI = "/cpus/idle-states/sodi";
		SODI3 = "/cpus/idle-states/sodi3";
		DPIDLE = "/cpus/idle-states/dpidle";
		SUSPEND = "/cpus/idle-states/suspend";
		cpu_dbgapb = "/cpu_dbgapb@0d410000";
		msdc0 = "/msdc@11230000";
		msdc1 = "/msdc@11240000";
		reserved_memory = "/reserved-memory";
		gic = "/interrupt-controller@0c000000";
		sysirq = "/intpol-controller@0c530620";
		timer = "/timer";
		clk_null = "/clocks/clk_null";
		clk26m = "/clocks/clk26m";
		clk32k = "/clocks/clk32k";
		topckgen = "/topckgen@10000000";
		infracfg_ao = "/infracfg_ao@10001000";
		scpsys = "/scpsys@10001000";
		gpio_usage_mapping = "/gpio";
		gpio = "/gpio@10005000";
		syscfg_pctl_a = "/syscfg_pctl_a@10005000";
		syscfg_pctl_0 = "/syscfg_pctl_0@11f20000";
		syscfg_pctl_1 = "/syscfg_pctl_1@11e80000";
		syscfg_pctl_2 = "/syscfg_pctl_2@11e70000";
		syscfg_pctl_3 = "/syscfg_pctl_3@11e90000";
		syscfg_pctl_4 = "/syscfg_pctl_4@11d30000";
		syscfg_pctl_5 = "/syscfg_pctl_5@11d20000";
		syscfg_pctl_6 = "/syscfg_pctl_6@11c50000";
		syscfg_pctl_7 = "/syscfg_pctl_7@11f30000";
		pio = "/pinctrl@1000b000";
		msdc0_pins_default = "/pinctrl@1000b000/msdc0@default";
		msdc0_register_setting_default = "/pinctrl@1000b000/msdc0@register_default";
		msdc1_pins_default = "/pinctrl@1000b000/msdc1@default";
		msdc1_pins_sdr104 = "/pinctrl@1000b000/msdc1@sdr104";
		msdc1_pins_sdr50 = "/pinctrl@1000b000/msdc1@sdr50";
		msdc1_pins_ddr50 = "/pinctrl@1000b000/msdc1@ddr50";
		msdc1_register_setting_default = "/pinctrl@1000b000/msdc1@register_default";
		i2c0 = "/i2c@11007000";
		i2c1 = "/i2c@11011000";
		i2c2 = "/i2c@11009000";
		i2c3 = "/i2c@1100f000";
		i2c4 = "/i2c@11008000";
		i2c5 = "/i2c@11017000";
		i2c6 = "/i2c@11005000";
		i2c7 = "/i2c@1101a000";
		i2c8 = "/i2c@1101b000";
		i2c9 = "/i2c@11014000";
		i2c10 = "/i2c@11015000";
		i2c11 = "/i2c@11016000";
		apmixed = "/apmixed@1000c000";
		main_pmic = "/pwrap@1000d000/pmic_irq";
		keypad = "/kp@10010000";
		mrdump_ext_rst = "/mrdump_ext_rst";
		scp = "/scp@10500000";
		wifi = "/wifi@180f0000";
		mdcldma = "/mdcldma@10014000";
		auxadc = "/auxadc@11001000";
		apdma = "/dma-controller@11000780";
		apuart0 = "/serial@11002000";
		apuart1 = "/serial@11003000";
		apuart2 = "/serial@11004000";
		spi0 = "/spi@1100a000";
		spi1 = "/spi@11010000";
		spi2 = "/spi@11012000";
		spi3 = "/spi@11013000";
		spi4 = "/spi@11018000";
		spi5 = "/spi@11019000";
		consys = "/consys@18070000";
		irtx_pwm = "/irtx_pwm";
		usb0 = "/usb3@11200000";
		xhci0 = "/usb3_xhci@11200000";
		audio = "/audio@11220000";
		audgpio = "/mt_soc_dl1_pcm@11220000";
		ufshci = "/ufshci@11270000";
		mfgcfg = "/mfgcfg@13000000";
		mmsys_config = "/mmsys_config@14000000";
		touch = "/touch";
		accdet = "/accdet";
		bat_gm30 = "/battery";
		mdp_rdma0 = "/mdp_rdma0@14001000";
		mdp_rdma1 = "/mdp_rdma1@14002000";
		mdp_rsz0 = "/mdp_rsz0@14003000";
		mdp_rsz1 = "/mdp_rsz1@14004000";
		mdp_wrot0 = "/mdp_wrot0@14005000";
		mdp_wdma = "/mdp_wdma@14006000";
		mdp_tdshp = "/mdp_tdshp@14007000";
		mtkfb = "/mtkfb@0";
		alsps = "/als_ps@0";
		dsi_te = "/dsi_te";
		mhl = "/mhl@0";
		disp_color0 = "/disp_color0@1400e000";
		disp_aal0 = "/disp_aal0@14010000";
		disp_mutex = "/disp_mutex@14016000";
		smi_larb0 = "/smi_larb0@14017000";
		mdp_aal = "/mdp_aal@1401b000";
		mdp_ccorr = "/mdp_ccorr@1401c000";
		vdec_gcon = "/vdec_gcon@16000000";
		smi_larb1 = "/smi_larb1@16010000";
		venc_gcon = "/venc_gcon@17000000";
		smi_larb4 = "/smi_larb4@17010000";
		venc = "/venc@17020000";
		imgsys = "/imgsys@15020000";
		smi_larb2 = "/smi_larb2@1502f000";
		smi_larb5 = "/smi_larb5@15021000";
		camsys = "/camsys@1a000000";
		ipu_conn = "/ipu_conn@19000000";
		ipu_adl = "/ipu_adl@19010000";
		ipu0 = "/ipu0@19180000";
		ipu1 = "/ipu1@19280000";
		smi_larb3 = "/smi_larb3@1a002000";
		smi_larb6 = "/smi_larb6@1a001000";
		kd_camera_hw1 = "/kd_camera_hw1@1a040000";
		hct_device = "/hct_device";
		flashlight_core = "/flashlight_core";
		flashlights_lm3642 = "/flashlights_lm3642";
		flashlights_ha7109 = "/flashlights_ha7109";
		flashlights_mt6370 = "/flashlights_mt6370";
		flashlights_rt4509 = "/flashlights_rt4509";
		usbphy0 = "/usbphy";
		odm = "/odm";
		radio_md_cfg = "/radio_md_cfg";
		dynamic_options = "/dynamic_options";
		mt_charger = "/mt_charger";
		lk_charger = "/lk_charger";
		charger = "/charger";
		rt9465_slave_chr = "/rt9465_slave_chr";
		subpmic_pmu_eint = "/mt6370_pmu_eint";
		goodix_fp = "/fingerprint";
		hct_finger = "/hct_finger";
		tcpc_pd = "/mt6370_pd_eint";
		rt5081_pmu_eint = "/rt5081_pmu_eint";
		rt5081_pd = "/rt5081_pd_eint";
		pmic_clock_buffer_ctrl = "/pmic_clock_buffer_ctrl";
		msdc1_ins = "/msdc1_ins";
		gyroscope = "/gyroscope";
		mse = "/mse";
		als = "/als";
		otg_iddig = "/otg_iddig";
		nfc = "/nfc";
		irq_nfc = "/irq_nfc";
		ultraviolet = "/ultraviolet";
		heart_rate = "/heart_rate";
		barometer = "/barometer";
		smart_pa = "/smart_pa";
		md1_sim1_hot_plug_eint = "/md1_sim1_hot_plug_eint";
		md1_sim2_hot_plug_eint = "/md1_sim2_hot_plug_eint";
		usb_c_pinctrl = "/usb_c_pinctrl";
		ssusb_ip_sleep = "/ssusb_ip_sleep";
		mt_pmic_vdram1_buck_reg = "/mt_pmic_regulator/buck_regulators/buck_vdram1";
		mt_pmic_vcore_buck_reg = "/mt_pmic_regulator/buck_regulators/buck_vcore";
		mt_pmic_vpa_buck_reg = "/mt_pmic_regulator/buck_regulators/buck_vpa";
		mt_pmic_vproc11_buck_reg = "/mt_pmic_regulator/buck_regulators/buck_vproc11";
		mt_pmic_vproc12_buck_reg = "/mt_pmic_regulator/buck_regulators/buck_vproc12";
		mt_pmic_vgpu_buck_reg = "/mt_pmic_regulator/buck_regulators/buck_vgpu";
		mt_pmic_vs2_buck_reg = "/mt_pmic_regulator/buck_regulators/buck_vs2";
		mt_pmic_vmodem_buck_reg = "/mt_pmic_regulator/buck_regulators/buck_vmodem";
		mt_pmic_vs1_buck_reg = "/mt_pmic_regulator/buck_regulators/buck_vs1";
		mt_pmic_vdram2_ldo_reg = "/mt_pmic_regulator/ldo_regulators/ldo_vdram2";
		mt_pmic_vsim1_ldo_reg = "/mt_pmic_regulator/ldo_regulators/ldo_vsim1";
		mt_pmic_vibr_ldo_reg = "/mt_pmic_regulator/ldo_regulators/ldo_vibr";
		mt_pmic_vrf12_ldo_reg = "/mt_pmic_regulator/ldo_regulators/ldo_vrf12";
		mt_pmic_vio18_ldo_reg = "/mt_pmic_regulator/ldo_regulators/ldo_vio18";
		mt_pmic_vusb_ldo_reg = "/mt_pmic_regulator/ldo_regulators/ldo_vusb";
		mt_pmic_vcamio_ldo_reg = "/mt_pmic_regulator/ldo_regulators/ldo_vcamio";
		mt_pmic_vcamd_ldo_reg = "/mt_pmic_regulator/ldo_regulators/ldo_vcamd";
		mt_pmic_vcn18_ldo_reg = "/mt_pmic_regulator/ldo_regulators/ldo_vcn18";
		mt_pmic_vfe28_ldo_reg = "/mt_pmic_regulator/ldo_regulators/ldo_vfe28";
		mt_pmic_vsram_proc11_ldo_reg = "/mt_pmic_regulator/ldo_regulators/ldo_vsram_proc11";
		mt_pmic_vcn28_ldo_reg = "/mt_pmic_regulator/ldo_regulators/ldo_vcn28";
		mt_pmic_vsram_others_ldo_reg = "/mt_pmic_regulator/ldo_regulators/ldo_vsram_others";
		mt_pmic_vsram_gpu_ldo_reg = "/mt_pmic_regulator/ldo_regulators/ldo_vsram_gpu";
		mt_pmic_vxo22_ldo_reg = "/mt_pmic_regulator/ldo_regulators/ldo_vxo22";
		mt_pmic_vefuse_ldo_reg = "/mt_pmic_regulator/ldo_regulators/ldo_vefuse";
		mt_pmic_vaux18_ldo_reg = "/mt_pmic_regulator/ldo_regulators/ldo_vaux18";
		mt_pmic_vmch_ldo_reg = "/mt_pmic_regulator/ldo_regulators/ldo_vmch";
		mt_pmic_vbif28_ldo_reg = "/mt_pmic_regulator/ldo_regulators/ldo_vbif28";
		mt_pmic_vsram_proc12_ldo_reg = "/mt_pmic_regulator/ldo_regulators/ldo_vsram_proc12";
		mt_pmic_vcama1_ldo_reg = "/mt_pmic_regulator/ldo_regulators/ldo_vcama1";
		mt_pmic_vemc_ldo_reg = "/mt_pmic_regulator/ldo_regulators/ldo_vemc";
		mt_pmic_vio28_ldo_reg = "/mt_pmic_regulator/ldo_regulators/ldo_vio28";
		mt_pmic_va12_ldo_reg = "/mt_pmic_regulator/ldo_regulators/ldo_va12";
		mt_pmic_vrf18_ldo_reg = "/mt_pmic_regulator/ldo_regulators/ldo_vrf18";
		mt_pmic_vcn33_bt_ldo_reg = "/mt_pmic_regulator/ldo_regulators/ldo_vcn33_bt";
		mt_pmic_vcn33_wifi_ldo_reg = "/mt_pmic_regulator/ldo_regulators/ldo_vcn33_wifi";
		mt_pmic_vcama2_ldo_reg = "/mt_pmic_regulator/ldo_regulators/ldo_vcama2";
		mt_pmic_vmc_ldo_reg = "/mt_pmic_regulator/ldo_regulators/ldo_vmc";
		mt_pmic_vldo28_ldo_reg = "/mt_pmic_regulator/ldo_regulators/ldo_vldo28";
		mt_pmic_vaud28_ldo_reg = "/mt_pmic_regulator/ldo_regulators/ldo_vaud28";
		mt_pmic_vsim2_ldo_reg = "/mt_pmic_regulator/ldo_regulators/ldo_vsim2";
		mt_pmic_va09_ldo_reg = "/mt_pmic_regulator/ldo_regulators/ldo_va09";
		mt6370_pmu = "/mt6370_pmu_dts";
		mt6370_typec = "/type_c_port0";
	};
};
